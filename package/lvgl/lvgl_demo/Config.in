## package/lvgl/lvgl_demo/Config.in
```kconfig
config BR2_PACKAGE_LVGL_DEMO
	bool "LVGL DEMO"
	default n
	help
	  lvgl demo

choice
	prompt "LVGL APP select"
	depends on BR2_PACKAGE_LVGL_DEMO
	config BR2_PACKAGE_LVGL_DEMO_WIDGETS
		bool "lvgl demo widgets"
		select BR2_PACKAGE_LVGL_DEMOS
		help
		  Enbale lvgl demo widgets

	config BR2_PACKAGE_LVGL_DEMO_KEYPAD_AND_ENCODER
		bool "lvgl demo keypad and encoder"
		select BR2_PACKAGE_LVGL_DEMOS
		help
		  Enbale lvgl demo keypad and encoder

	config BR2_PACKAGE_LVGL_DEMO_BENCHMARK
		bool "lvgl demo benchmark"
		select BR2_PACKAGE_LVGL_DEMOS
		help
		  Enbale lvgl demo benchmark

	config BR2_PACKAGE_LVGL_DEMO_STRESS
		bool "lvgl demo stress"
		select BR2_PACKAGE_LVGL_DEMOS
		help
		  Enbale lvgl demo stress

	config BR2_PACKAGE_LVGL_DEMO_MUSIC
		bool "lvgl demo music"
		select BR2_PACKAGE_LVGL_DEMOS
		help
		  Enbale lvgl demo music

	config BR2_PACKAGE_LVGL_DEMO_CUSTOM
		bool "lvgl demo custom"
		select BR2_PACKAGE_LVGL_DEMOS
		help
		  Enbale lvgl demo custom

	config BR2_PACKAGE_RK_DEMO
		bool "RK demo"
		select BR2_PACKAGE_RKWIFIBT_APP
		select BR2_PACKAGE_RKADK
		select BR2_PACKAGE_COMMON_ALGORITHM
		select BR2_PACKAGE_COMMON_ALGORITHM_RKAPPLUS
		help
		  Rockchip LVGL demo

endchoice
```

## package/rockchip/Config.in
```kconfig
menuconfig BR2_PACKAGE_ROCKCHIP
	bool "Rockchip Platform"

if BR2_PACKAGE_ROCKCHIP

config BR2_PACKAGE_ROCKCHIP_HAS_ISP1
	bool
	help
	  Has Rockchip ISP1

config BR2_PACKAGE_ROCKCHIP_HAS_ISP2
	bool
	help
	  Has Rockchip ISP2

config BR2_PACKAGE_ROCKCHIP_HAS_ISP3
	bool
	help
	  Has Rockchip ISP3

choice
	default BR2_PACKAGE_RK3588
	prompt "Rockchip SoC"

config BR2_PACKAGE_RV1126_RV1109
	bool "rv1126/rv1109"
	select BR2_PACKAGE_ROCKCHIP_HAS_ISP2
	help
	  Use Rockchip's rv1126/rv1109 SoC.

config BR2_PACKAGE_RK1806
	bool "rk1806"
	select BR2_PACKAGE_ROCKCHIP_HAS_ISP1
	help
	  Use Rockchip's rk1806 SoC.

config BR2_PACKAGE_RK1808
	bool "rk1808"
	select BR2_PACKAGE_ROCKCHIP_HAS_ISP1
	help
	  Use Rockchip's rk1808 SoC.

config BR2_PACKAGE_RK3032
	bool "rk3032"
	help
	  Use Rockchip's rk3032 SoC.

config BR2_PACKAGE_RK3036
	bool "rk3036"
	help
	  Use Rockchip's rk3036 SoC.

config BR2_PACKAGE_PX3SE
	bool "px3se"
	help
	  Use Rockchip's px3se SoC.

config BR2_PACKAGE_RK312X
	bool "rk312X"
	select BR2_PACKAGE_ROCKCHIP_HAS_ISP1
	help
	  Use Rockchip's rk312X SoC.

config BR2_PACKAGE_RK3128H
	bool "rk3128H"
	help
	  Use Rockchip's rk3128H box SoC.

config BR2_PACKAGE_RK3229
	bool "rk3229"
	help
	  Use Rockchip's rk3229 SoC.

config BR2_PACKAGE_RK3288
	bool "rk3288"
	select BR2_PACKAGE_ROCKCHIP_HAS_ISP1
	help
	  Use Rockchip's rk3288 SoC.

config BR2_PACKAGE_RK3308
	bool "rk3308"
	help
	  Use Rockchip's rk3308 SoC.

config BR2_PACKAGE_RK3326
	bool "rk3326"
	select BR2_PACKAGE_ROCKCHIP_HAS_ISP1
	help
	  Use Rockchip's rk3326 SoC.

config BR2_PACKAGE_PX30
	bool "px30"
	select BR2_PACKAGE_ROCKCHIP_HAS_ISP1
	help
	  Use Rockchip's px30 SoC.

config BR2_PACKAGE_RK3328
	bool "rk3328"
	help
	  Use Rockchip's rk3328 SoC.

config BR2_PACKAGE_RK3358
	bool "rk3358"
	select BR2_PACKAGE_ROCKCHIP_HAS_ISP1
	help
	  Use Rockchip's rk3358 SoC.

config BR2_PACKAGE_RK3399
	bool "rk3399"
	select BR2_PACKAGE_ROCKCHIP_HAS_ISP1
	help
	  Use Rockchip's rk3399 SoC.

config BR2_PACKAGE_RK3399PRO
	bool "rk3399pro"
	select BR2_PACKAGE_ROCKCHIP_HAS_ISP1
	help
	  Use Rockchip's rk3399pro SoC.

config BR2_PACKAGE_RK3399PRO_NPU
	bool "rk3399pro npu"
	select BR2_PACKAGE_ROCKCHIP_HAS_ISP1
	help
	  Use Rockchip's rk3399pro npu SoC.

config BR2_PACKAGE_RK3528
	bool "rk3528"
	help
	  Use Rockchip's rk3528 SoC.

config BR2_PACKAGE_RK3562
	bool "rk3562"
	select BR2_PACKAGE_ROCKCHIP_HAS_ISP2
	help
	  Use Rockchip's rk3562 SoC.

config BR2_PACKAGE_RK3566_RK3568
	bool "rk3566/rk3568"
	select BR2_PACKAGE_ROCKCHIP_HAS_ISP2
	help
	  Use Rockchip's rk3566/rk3568 SoC.

config BR2_PACKAGE_RK3588
	bool "rk3588"
	select BR2_PACKAGE_ROCKCHIP_HAS_ISP3
	help
	  Use Rockchip's rk3588 SoC.

endchoice

# Camera Engine packages
config BR2_PACKAGE_CAMERA_ENGINE
	bool "Rockchip Camera Engine For ISP"
	depends on BR2_PACKAGE_ROCKCHIP_HAS_ISP1 || BR2_PACKAGE_ROCKCHIP_HAS_ISP2 || BR2_PACKAGE_ROCKCHIP_HAS_ISP3
	select BR2_PACKAGE_CAMERA_ENGINE_RKISP if BR2_PACKAGE_ROCKCHIP_HAS_ISP1
	select BR2_PACKAGE_CAMERA_ENGINE_RKAIQ if BR2_PACKAGE_ROCKCHIP_HAS_ISP2
	select BR2_PACKAGE_CAMERA_ENGINE_RKAIQ if BR2_PACKAGE_ROCKCHIP_HAS_ISP3
	help
	  Depend on Chip Type, there are different camera_engine packages.
	  Enable this config to choose camera_engine package by chip automatically.

menu "Rockchip BSP packages"
	source "package/rockchip/camera-engine-rkisp/Config.in"
	source "package/rockchip/camera-engine-rkaiq/Config.in"
	source "package/rockchip/ros/Config.in"
	source "package/rockchip/address_sanitizer/Config.in"
	source "package/rockchip/gstreamer1-rockchip/Config.in"
	source "package/rockchip/pcba/Config.in"
	source "package/rockchip/softap/Config.in"
	source "package/rockchip/softapServer/Config.in"
	source "package/rockchip/wifiAutoSetup/Config.in"
	source "package/rockchip/uvc_app/Config.in"
	source "package/rockchip/uac_app/Config.in"
	source "package/rockchip/rkwifibt/Config.in"
	source "package/rockchip/rkwifibt-app/Config.in"
	source "package/rockchip/rockchip-alsa-config/Config.in"
	source "package/rockchip/rockchip-rga/Config.in"
	source "package/rockchip/rockchip-mali/Config.in"
	source "package/rockchip/rockchip-mpp/Config.in"
	source "package/rockchip/eq_drc_process/Config.in"
	source "package/rockchip/alsa_ladspa/Config.in"
	source "package/rockchip/rockchip-test/Config.in"
	source "package/rockchip/rockchip-uac-app/Config.in"
	source "package/rockchip/rockit/Config.in"
	source "package/rockchip/broadcom_bsa/Config.in"
	source "package/rockchip/cypress_bsa/Config.in"
	source "package/rockchip/recovery/Config.in"
	source "package/rockchip/rkupdate/Config.in"
	source "package/rockchip/rktoolkit/Config.in"
	source "package/rockchip/rkmedia/Config.in"
	source "package/rockchip/rockit/Config.in"
	source "package/rockchip/rkadk/Config.in"
	source "package/rockchip/recoverySystem/Config.in"
	source "package/rockchip/npu_powerctrl/Config.in"
	source "package/rockchip/npu_powerctrl_combine/Config.in"
	source "package/rockchip/n4/Config.in"
	source "package/rockchip/minigui/Config.in"
	source "package/rockchip/rknpu/Config.in"
	source "package/rockchip/rknpu2/Config.in"
	source "package/rockchip/rknpu-fw/Config.in"
	source "package/rockchip/rknn_demo/Config.in"
	source "package/rockchip/ficial_gate/Config.in"
	source "package/rockchip/rkfacial/Config.in"
	source "package/rockchip/pose_body/Config.in"
	source "package/rockchip/face_detect/Config.in"
	source "package/rockchip/rockx/Config.in"
	source "package/rockchip/rockface/Config.in"
	source "package/rockchip/rkscript/Config.in"
	source "package/rockchip/deviceio/Config.in"
	source "package/rockchip/deviceio_release/Config.in"
	source "package/rockchip/libavb/Config.in"
	source "package/rockchip/libavb_ab/Config.in"
	source "package/rockchip/libavb_user/Config.in"
	source "package/rockchip/libv4l-rkmpp/Config.in"
	source "package/rockchip/bootcontrol/Config.in"
	source "package/rockchip/common_algorithm/Config.in"
	source "package/rockchip/ipcweb-backend/Config.in"
	source "package/rockchip/libgdbus/Config.in"
	source "package/rockchip/libIPCProtocol/Config.in"
	source "package/rockchip/librkdb/Config.in"
	source "package/rockchip/dbserver/Config.in"
	source "package/rockchip/netserver/Config.in"
	source "package/rockchip/storage_manager/Config.in"
	source "package/rockchip/mediaserver/Config.in"
	source "package/rockchip/aiserver/Config.in"
	source "package/rockchip/minilogger/Config.in"
	source "package/rockchip/ipc-daemon/Config.in"
	source "package/rockchip/CallFunIpc/Config.in"
	source "package/rockchip/isp2-ipc/Config.in"
	source "package/rockchip/smart_display_service/Config.in"
	source "package/rockchip/rksl/Config.in"
	source "package/rockchip/sl_lock/Config.in"
	source "package/rockchip/mult_uvc_demo/Config.in"
	source "package/rockchip/pcba_adb_test/Config.in"
	source "package/rockchip/thunderboot/Config.in"
	source "package/rockchip/startup_app_ipc/Config.in"
	source "package/rockchip/rkaiq_tool_server/Config.in"
	source "package/rockchip/cvr_app/Config.in"
	source "package/rockchip/rkipc/Config.in"
	source "package/rockchip/rkfsmk/Config.in"
	source "package/rockchip/slt_gpu_light/Config.in"
	source "package/rockchip/tee-user-app/Config.in"
endmenu

endif
```

## package/rockchip/apps/qsetting/Config.in
```kconfig
config BR2_PACKAGE_QSETTING
	bool "qsetting"
	depends on BR2_PACKAGE_QT5
	help
	  Rockchip setting application based on Qt
```

## package/rockchip/lvgl/Config.in
```kconfig
config BR2_PACKAGE_LVGL
	bool "lvgl"
	default n
	help
	  lvgl

if BR2_PACKAGE_LVGL
	config BR2_PACKAGE_LVGL_CONF
		string "Lvgl configuration file"
		default "lv_conf_default.h"
endif
```

## package/rockchip/rkadk/Config.in
```kconfig
config BR2_PACKAGE_RKADK
	bool "rkadk"
	select BR2_PACKAGE_ROCKIT
	select BR2_PACKAGE_COMMON_ALGORITHM
	default n
	help
		rkadk
```

## package/rockchip/rkipc/Config.in
```kconfig
config BR2_PACKAGE_RKIPC
	bool "rockchip rkipc"
	select BR2_PACKAGE_CAMERA_ENGINE_RKAIQ
	help
	  rockchip rkipc

choice
prompt "Platform type"
	default BR2_PACKAGE_RKIPC_RK356X
	help
	  Select a platform type.

config BR2_PACKAGE_RKIPC_LOW_MEMORY
        bool "Compile for low memory ipc"
        select BR2_PACKAGE_ROCKIT
        depends on BR2_PACKAGE_RKIPC

config BR2_PACKAGE_RKIPC_RV1126
	bool "Compile for rv1126"
	select BR2_PACKAGE_ROCKIT
	select BR2_PACKAGE_WPA_SUPPLICANT
	depends on BR2_PACKAGE_RKIPC

config BR2_PACKAGE_RKIPC_RV1126_BATTERY_IPC
        bool "Compile for rv1126 battery ipc"
        select BR2_PACKAGE_RKMEDIA
        depends on BR2_PACKAGE_RKIPC

config BR2_PACKAGE_RKIPC_RV1126_SNAPSHOT
        bool "Compile for rv1126 snapshot"
        select BR2_PACKAGE_RKMEDIA
        depends on BR2_PACKAGE_RKIPC

config BR2_PACKAGE_RKIPC_RK356X
	bool "Compile for rk356x"
	select BR2_PACKAGE_ROCKIT
	select BR2_PACKAGE_WPA_SUPPLICANT
	depends on BR2_PACKAGE_RKIPC

config BR2_PACKAGE_RKIPC_RK3588
	bool "Compile for rk3588"
	select BR2_PACKAGE_ROCKIT
	select BR2_PACKAGE_WPA_SUPPLICANT
	depends on BR2_PACKAGE_RKIPC
endchoice
```

## package/rockchip/rkpartybox/Config.in
```kconfig
config BR2_PACKAGE_RKPARTYBOX
	bool "RKPARTYBOX demo"
	depends on BR2_aarch64
	depends on BR2_PACKAGE_HAS_UDEV
	depends on BR2_PACKAGE_WPA_SUPPLICANT
	help
	  rkpartybox demo

config BR2_PACKAGE_RK3308_CORE_BOARD
	bool "RKPARTYBOX core board only"
	depends on BR2_PACKAGE_RKPARTYBOX
	help
	  partybox core board only

config BR2_PACKAGE_PBOX_LCD_DISPLAY
	bool "RKPARTYBOX LCD display"
	depends on !BR2_PACKAGE_RK3308_CORE_BOARD
	default y if BR2_PACKAGE_RKPARTYBOX
	help
	  partybox lcd display

config BR2_PACKAGE_PBOX_LED_EFFECT
	bool "RKPARTYBOX led effect"
	depends on BR2_PACKAGE_RKPARTYBOX
	default y
	help
	  partybox led effect demo

config BR2_PACKAGE_ONCHIP_MIC
	bool "RKPARTYBOX on-chip MICs"
	depends on BR2_PACKAGE_RKPARTYBOX
	default y
	help
	  partybox rockchip on-chip MICs

config BR2_PACKAGE_MIC_NUM
	int "Mics or guitar input numbers"
	range 1 3
	default 1
	depends on BR2_PACKAGE_ONCHIP_MIC
	help
	  number of on-chip Mics or guitar inputs

config BR2_PACKAGE_RKCHIP_SARADC
	bool "RKPARTYBOX on-chip rotary adc keys"
	depends on BR2_PACKAGE_RKPARTYBOX
	help
	  partybox rockchip on-chip rotary adc keys
```

## package/rockchip/rockchip-rga/Config.in
```kconfig
config BR2_PACKAGE_ROCKCHIP_RGA
	bool "rockchip-rga"
	select BR2_PACKAGE_LIBDRM
	help
	  Rockchip RGA 2D accelerator userspace library.

if BR2_PACKAGE_ROCKCHIP_RGA
config BR2_PREFER_ROCKCHIP_RGA
	bool "prefer using rockchip-rga"
	help
	  Prefer using rockchip-rga when available.
endif
```

## package/rockchip/rockit/Config.in
```kconfig
config BR2_PACKAGE_ROCKIT
	bool "rockit"
	select BR2_PACKAGE_ROCKCHIP_MPP
	select BR2_PACKAGE_ALSA_PLUGINS
	default n
	help
		rockit
```
