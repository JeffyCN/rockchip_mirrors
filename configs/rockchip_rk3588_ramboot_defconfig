## configs/rockchip_rv1126_rv1109_tiny_defconfig
```kconfig
#include "base/base.config"
#include "chips/rv1126_rv1109_arm.config"
#include "multimedia/audio.config"
#include "multimedia/camera.config"
#include "multimedia/mpp.config"
BR2_ARM_INSTRUCTIONS_THUMB2=y
# BR2_PACKAGE_ALSA_PLUGINS is reset to default
# BR2_PACKAGE_ALSA_UCM_CONF is reset to default
# BR2_PACKAGE_ALSA_UTILS is reset to default
# BR2_PACKAGE_ALSA_UTILS_ALSACONF is reset to default
# BR2_PACKAGE_ALSA_UTILS_AMIXER is reset to default
# BR2_PACKAGE_ALSA_UTILS_APLAY is reset to default
# BR2_PACKAGE_ANDROID_TOOLS is reset to default
# BR2_PACKAGE_BUSYBOX_CONFIG_FRAGMENT_FILES is reset to default
# BR2_PACKAGE_BUSYBOX_SHOW_OTHERS is reset to default
# BR2_PACKAGE_CAMERA_ENGINE is reset to default
BR2_PACKAGE_CAMERA_ENGINE_RKAIQ_IQFILE="os04a10_CMK-OT1607-FV1_M12-40IRC-4MP-F16.xml imx335_MTV4-IR-E-P_40IRC-4MP-F16.xml imx415_YT10092_IR0147-36IRC-8M-F20.xml"
BR2_PACKAGE_COMMON_ALGORITHM_RKAPPLUS=y
BR2_PACKAGE_DRM_DISPLAY_OUTPUT=y
# BR2_PACKAGE_E2FSPROGS is reset to default
# BR2_PACKAGE_E2FSPROGS_RESIZE2FS is reset to default
# BR2_PACKAGE_EUDEV_ENABLE_HWDB is not set
BR2_PACKAGE_HOST_E2FSPROGS=y
# BR2_PACKAGE_IFUPDOWN_SCRIPTS is not set
# BR2_PACKAGE_INPUT_EVENT_DAEMON is reset to default
BR2_PACKAGE_IPCWEB_BACKEND=y
BR2_PACKAGE_IPCWEB_BACKEND_USE_RKIPC=y
# BR2_PACKAGE_LIBMAD is reset to default
BR2_PACKAGE_LIBPNG=y
# BR2_PACKAGE_MINIGUI_SOFTWARE_SCALE is not set
BR2_PACKAGE_MTD=y
# BR2_PACKAGE_MTD_MTD_DEBUG is not set
# BR2_PACKAGE_MTD_MTDINFO is not set
# BR2_PACKAGE_MTD_NANDDUMP is not set
# BR2_PACKAGE_MTD_NANDTEST is not set
# BR2_PACKAGE_MTD_NANDWRITE is not set
# BR2_PACKAGE_MTD_UBIATTACH is not set
# BR2_PACKAGE_MTD_UBIBLOCK is not set
# BR2_PACKAGE_MTD_UBICRC32 is not set
# BR2_PACKAGE_MTD_UBIDETACH is not set
# BR2_PACKAGE_MTD_UBIFORMAT is not set
# BR2_PACKAGE_MTD_UBIMKVOL is not set
# BR2_PACKAGE_MTD_UBINFO is not set
# BR2_PACKAGE_MTD_UBINIZE is not set
# BR2_PACKAGE_MTD_UBIRENAME is not set
# BR2_PACKAGE_MTD_UBIRMVOL is not set
# BR2_PACKAGE_MTD_UBIRSVOL is not set
# BR2_PACKAGE_MTD_UBIUPDATEVOL is not set
BR2_PACKAGE_OEM=y
BR2_PACKAGE_OEM_PACKAGES="rkipc rkmedia ipcweb-backend"
# BR2_PACKAGE_PM_UTILS is reset to default
BR2_PACKAGE_RKFSMK=y
BR2_PACKAGE_RKIPC=y
BR2_PACKAGE_RKIPC_RV1126=y
BR2_PACKAGE_RKMEDIA_ALSA=y
BR2_PACKAGE_RKMEDIA_ALSA_CAPTURE=y
BR2_PACKAGE_RKMEDIA_ALSA_PLAYBACK=y
BR2_PACKAGE_RKMEDIA_AUDIO_ALGORITHM=y
BR2_PACKAGE_RKMEDIA_AUDIO_CODEC=y
BR2_PACKAGE_RKMEDIA_AUDIO_ENCODER=y
BR2_PACKAGE_RKMEDIA_LIVE555=y
BR2_PACKAGE_RKMEDIA_MPP=y
BR2_PACKAGE_RKMEDIA_RKRGA=y
BR2_PACKAGE_RKMEDIA_RTSP_SERVER=y
BR2_PACKAGE_RKMEDIA_RTSP_SERVER_H264=y
BR2_PACKAGE_RKMEDIA_RTSP_SERVER_H265=y
BR2_PACKAGE_RKMEDIA_USE_AIQ=y
BR2_PACKAGE_RKMEDIA_V4L2_CAPTURE=y
# BR2_PACKAGE_ROCKCHIP_ALSA_CONFIG is reset to default
# BR2_PACKAGE_ROCKCHIP_MPP is reset to default
# BR2_PACKAGE_ROCKCHIP_MPP_ALLOCATOR_DRM is reset to default
# BR2_PACKAGE_ROCKCHIP_RGA is reset to default
# BR2_PACKAGE_UPDATE is reset to default
# BR2_PACKAGE_USBMOUNT is reset to default
# BR2_PACKAGE_UTIL_LINUX_MOUNT is reset to default
# BR2_PACKAGE_VENDOR_STORAGE is reset to default
BR2_ROOTFS_OVERLAY+="board/rockchip/rv1126_rv1109/fs-overlay-sysv/"
# BR2_TARGET_ROOTFS_EXT2 is reset to default
# BR2_TARGET_ROOTFS_EXT2_4 is reset to default
# BR2_TARGET_ROOTFS_EXT2_SIZE is reset to default
BR2_TARGET_ROOTFS_JFFS2=y
BR2_TARGET_ROOTFS_JFFS2_FLASH_64=y
BR2_TARGET_ROOTFS_SQUASHFS4_XZ=y
# BR2_TARGET_ROOTFS_TAR is not set
```

## configs/rockchip_rv1126_rv1109_uvcc_defconfig
```kconfig
#include "base/base.config"
#include "chips/rv1126_rv1109_arm.config"
#include "multimedia/audio.config"
#include "multimedia/camera.config"
#include "multimedia/mpp.config"
#include "debug.config"
BR2_PACKAGE_AISERVER=y
BR2_PACKAGE_AISERVER_SHM_SERVER=y
BR2_PACKAGE_AISERVER_USE_ROCKX=y
BR2_PACKAGE_CALLFUNIPC=y
BR2_PACKAGE_CAMERA_ENGINE_RKAIQ_IQFILE="os04a10_CMK-OT1607-FV1_M12-40IRC-4MP-F16.xml gc4c33_PCORW0009A_40IRC-4M.xml imx378_A12N01B_48IRC-12M-F18.xml"
BR2_PACKAGE_DBSERVER=y
BR2_PACKAGE_DBUS_GLIB=y
BR2_PACKAGE_GDB=y
BR2_PACKAGE_GDB_DEBUGGER=y
BR2_PACKAGE_ISP2_IPC=y
BR2_PACKAGE_ISP2_IPC_DBSERVER=y
BR2_PACKAGE_ISP2_IPC_DBUS=y
BR2_PACKAGE_LIBIPCPROTOCOL=y
# BR2_PACKAGE_PM_UTILS is reset to default
BR2_PACKAGE_SMART_DISPLAY_SERVICE=y
BR2_PACKAGE_UAC_APP=y
# BR2_PACKAGE_UPDATE is reset to default
# BR2_PACKAGE_USBMOUNT is reset to default
# BR2_PACKAGE_UTIL_LINUX_MOUNT is reset to default
BR2_PACKAGE_UVC_APP=y
# BR2_PACKAGE_VENDOR_STORAGE is reset to default
BR2_ROOTFS_OVERLAY+="board/rockchip/rv1126_rv1109/fs-overlay-uvc/"
```

## configs/rockchip_rv1126_rv1109_uvcc_spi_nand_defconfig
```kconfig
#include "base/base.config"
#include "audio.config"
#include "video_mpp.config"
#include "chips/rv1126_rv1109_arm.config"
#include "ubifs.config"
#include "camera.config"
BR2_PACKAGE_AISERVER=y
BR2_PACKAGE_AISERVER_SHM_SERVER=y
BR2_PACKAGE_AISERVER_USE_ROCKX=y
BR2_PACKAGE_CALLFUNIPC=y
BR2_PACKAGE_CAMERA_ENGINE_RKAIQ_IQFILE="gc4c33_PCORW0009A_40IRC-4M.xml"
BR2_PACKAGE_DBSERVER=y
BR2_PACKAGE_DBUS_GLIB=y
BR2_PACKAGE_E2FSPROGS=
BR2_PACKAGE_E2FSPROGS_RESIZE2FS=
BR2_PACKAGE_INPUT_EVENT_DAEMON=
BR2_PACKAGE_IO=y
BR2_PACKAGE_ISP2_IPC=y
BR2_PACKAGE_ISP2_IPC_DBSERVER=y
BR2_PACKAGE_ISP2_IPC_DBUS=y
BR2_PACKAGE_LIBIPCPROTOCOL=y
BR2_PACKAGE_LIBV4L=
BR2_PACKAGE_PM_UTILS=
BR2_PACKAGE_PROCPS_NG=y
BR2_PACKAGE_RECOVERY=y
BR2_PACKAGE_RECOVERY_BOOTCONTROL=y
BR2_PACKAGE_RECOVERY_UPDATEENGINEBIN=y
BR2_PACKAGE_RECOVERY_USE_UPDATEENGINE=y
BR2_PACKAGE_RKNPU_USE_MINI_DRIVER=y
BR2_PACKAGE_RK_OEM=y
BR2_PACKAGE_RK_OEM_RESOURCE_DIR="$(TOPDIR)/../device/rockchip/oem/oem_uvcc"
BR2_PACKAGE_RKSCRIPT=
BR2_PACKAGE_ROCKCHIP_MPP=
BR2_PACKAGE_SMART_DISPLAY_SERVICE=y
BR2_PACKAGE_UAC_APP=y
BR2_PACKAGE_UPDATE=
BR2_PACKAGE_USBMOUNT=
BR2_PACKAGE_UTIL_LINUX_MOUNT=
BR2_PACKAGE_UVC_APP=y
BR2_PACKAGE_VENDOR_STORAGE=
BR2_ROOTFS_DEVICE_CREATION_DYNAMIC_EUDEV=
BR2_ROOTFS_OVERLAY+="board/rockchip/rv1126_rv1109/fs-overlay-spi-nand-uvc/"
BR2_ROOTFS_POST_BUILD_SCRIPT+="board/rockchip/rv1126_rv1109/pack-uvc-oem.sh"
```

## configs/rockchip_rv1126_rv1109_uvcc_spi_nor_defconfig
```kconfig
#include "base/tiny.config"
#include "chips/rv1126_rv1109_arm.config"
#include "multimedia/audio.config"
#include "multimedia/camera.config"
#include "multimedia/mpp.config"
BR2_PACKAGE_AISERVER=y
BR2_PACKAGE_AISERVER_SHM_SERVER=y
# BR2_PACKAGE_ALSA_LIB_ALISP is not set
# BR2_PACKAGE_ALSA_LIB_ALOAD is not set
# BR2_PACKAGE_ALSA_LIB_OLD_SYMBOLS is not set
# BR2_PACKAGE_ALSA_LIB_SEQ is not set
BR2_PACKAGE_ANDROID_TOOLS=y
BR2_PACKAGE_CALLFUNIPC=y
BR2_PACKAGE_CAMERA_ENGINE_RKAIQ_IQFILE="os04a10_CMK-OT1607-FV1_M12-40IRC-4MP-F16.xml"
BR2_PACKAGE_DBSERVER=y
BR2_PACKAGE_DBUS_GLIB=y
# BR2_PACKAGE_E2FSPROGS is reset to default
BR2_PACKAGE_IO=y
BR2_PACKAGE_ISP2_IPC=y
BR2_PACKAGE_ISP2_IPC_DBSERVER=y
BR2_PACKAGE_ISP2_IPC_DBUS=y
BR2_PACKAGE_LIBIPCPROTOCOL=y
BR2_PACKAGE_MTD=y
# BR2_PACKAGE_MTD_MTD_DEBUG is not set
# BR2_PACKAGE_MTD_MTDINFO is not set
# BR2_PACKAGE_MTD_NANDDUMP is not set
# BR2_PACKAGE_MTD_NANDTEST is not set
# BR2_PACKAGE_MTD_NANDWRITE is not set
# BR2_PACKAGE_MTD_UBIATTACH is not set
# BR2_PACKAGE_MTD_UBIBLOCK is not set
# BR2_PACKAGE_MTD_UBICRC32 is not set
# BR2_PACKAGE_MTD_UBIDETACH is not set
# BR2_PACKAGE_MTD_UBIFORMAT is not set
# BR2_PACKAGE_MTD_UBIMKVOL is not set
# BR2_PACKAGE_MTD_UBINFO is not set
# BR2_PACKAGE_MTD_UBINIZE is not set
# BR2_PACKAGE_MTD_UBIRENAME is not set
# BR2_PACKAGE_MTD_UBIRMVOL is not set
# BR2_PACKAGE_MTD_UBIRSVOL is not set
# BR2_PACKAGE_MTD_UBIUPDATEVOL is not set
BR2_PACKAGE_UAC_APP=y
BR2_PACKAGE_UVC_APP=y
BR2_ROOTFS_OVERLAY="board/rockchip/common/base board/rockchip/rv1126_rv1109/fs-overlay-spi-nor-uvc/"
BR2_ROOTFS_POST_BUILD_SCRIPT+="board/rockchip/rv1126_rv1109/pack-oem.sh"
BR2_TARGET_GENERIC_ISSUE="Welcome to RV1126 rootfs"
BR2_TARGET_ROOTFS_JFFS2=y
BR2_TARGET_ROOTFS_JFFS2_FLASH_64=y
BR2_TARGET_ROOTFS_SQUASHFS4_XZ=y
# BR2_TARGET_ROOTFS_TAR is not set
```

## configs/rockchip_rv1126_sllock_defconfig
```kconfig
#include "base/tiny.config"
#include "chips/rv1126_rv1109_arm.config"
#include "multimedia/camera.config"
# BR2_PACKAGE_ALSA_LIB_ALISP is not set
# BR2_PACKAGE_ALSA_LIB_ALOAD is not set
# BR2_PACKAGE_ALSA_LIB_HWDEP is not set
# BR2_PACKAGE_ALSA_LIB_OLD_SYMBOLS is not set
# BR2_PACKAGE_ALSA_LIB_RAWMIDI is not set
# BR2_PACKAGE_ALSA_LIB_SEQ is not set
BR2_PACKAGE_ALSA_UTILS=y
# BR2_PACKAGE_ALSA_UTILS_ALSACTL is not set
BR2_PACKAGE_ALSA_UTILS_AMIXER=y
BR2_PACKAGE_ALSA_UTILS_APLAY=y
BR2_PACKAGE_CAMERA_ENGINE_RKAIQ_IQFILE="os04c10_DW-RV04C_2G2P650IR-F21.xml"
BR2_PACKAGE_CAMERA_ENGINE_RKAIQ_IQFILE_USE_BIN=y
BR2_PACKAGE_DRM_DISPLAY_OUTPUT=y
BR2_PACKAGE_EXPAT=y
# BR2_PACKAGE_IFUPDOWN_SCRIPTS is not set
BR2_PACKAGE_ISP2_IPC=y
BR2_PACKAGE_JSON_C=y
BR2_PACKAGE_LIBGLIB2=y
BR2_PACKAGE_MEDIASERVE_CONFIG="tb_rtsp-link.conf"
# BR2_PACKAGE_MEDIASERVE_DBUS is not set
BR2_PACKAGE_MEDIASERVE_ENABLE_CY43438=y
BR2_PACKAGE_MEDIASERVE_LINKAPI=y
BR2_PACKAGE_MEDIASERVE_LINKAPI_TUYA=y
BR2_PACKAGE_MEDIASERVE_LINKAPI_VENDOR=y
# BR2_PACKAGE_MEDIASERVE_MINILOGGER is not set
BR2_PACKAGE_MEDIASERVER=y
BR2_PACKAGE_MEDIASERVE_TB=y
# BR2_PACKAGE_MINIGUI_SOFTWARE_SCALE is not set
BR2_PACKAGE_RKMEDIA_ALSA=y
BR2_PACKAGE_RKMEDIA_ALSA_CAPTURE=y
BR2_PACKAGE_RKMEDIA_ALSA_PLAYBACK=y
BR2_PACKAGE_RKMEDIA_AUDIO_ALGORITHM=y
BR2_PACKAGE_RKMEDIA_EXAMPLES=y
BR2_PACKAGE_RKMEDIA_LIVE555=y
BR2_PACKAGE_RKMEDIA_MPP=y
# BR2_PACKAGE_RKMEDIA_MPP_DECODER is not set
BR2_PACKAGE_RKMEDIA_RKRGA=y
BR2_PACKAGE_RKMEDIA_RTSP_SERVER=y
BR2_PACKAGE_RKMEDIA_RTSP_SERVER_H264=y
BR2_PACKAGE_RKMEDIA_USE_AIQ=y
BR2_PACKAGE_RKMEDIA_V4L2_CAPTURE=y
BR2_PACKAGE_SL_LOCK=y
BR2_PACKAGE_THUNDERBOOT=y
BR2_PACKAGE_THUNDERBOOT_BATIPC_LAUNCH=y
BR2_PACKAGE_VENDOR_STORAGE=y
BR2_PACKAGE_WPA_SUPPLICANT=y
BR2_PACKAGE_WPA_SUPPLICANT_EAP=y
BR2_ROOTFS_OVERLAY="board/rockchip/rv1126_rv1109/fs-overlay-sllock"
BR2_TARGET_GENERIC_ISSUE="Welcome to Battery EVB with sllock"
BR2_THUNDERBOOT_EMMC=y
BR2_THUNDERBOOT_INSTALL_MODULES="dw_mmc-rockchip.ko,snd-soc-es8311.ko,rk_sdmmc_ops.ko,sdmmc_vendor_storage.ko"
BR2_THUNDERBOOT_SIMPLIFY_USB=y
BR2_THUNDERBOOT_USB_ADBD=y
```

## configs/rockchip_rv1126_snapshot_defconfig
```kconfig
#include "base/tiny.config"
#include "chips/rv1126_rv1109_arm.config"
#include "multimedia/camera.config"
# BR2_PACKAGE_CAMERA_ENGINE is reset to default
BR2_PACKAGE_CAMERA_ENGINE_RKAIQ_FAKE_CAMERA_IQFILE="os04c10_DW-RV04C_2G2P650IR-F21.xml"
BR2_PACKAGE_CAMERA_ENGINE_RKAIQ_IQFILE="os04c10_DW-RV04C_2G2P650IR-F21.xml"
BR2_PACKAGE_CAMERA_ENGINE_RKAIQ_IQFILE_USE_BIN=y
# BR2_PACKAGE_E2FSPROGS is reset to default
# BR2_PACKAGE_IFUPDOWN_SCRIPTS is not set
BR2_PACKAGE_LIBGLIB2=y
# BR2_PACKAGE_MINIGUI_SOFTWARE_SCALE is not set
BR2_PACKAGE_RKIPC=y
BR2_PACKAGE_THUNDERBOOT=y
BR2_PACKAGE_THUNDERBOOT_USE_EUDEV=y
BR2_ROOTFS_OVERLAY="board/rockchip/rv1126_rv1109/fs-overlay-snapshot"
BR2_TARGET_GENERIC_ISSUE="Welcome to Battery EVB"
BR2_THUNDERBOOT_INSTALL_MODULES="dw_mmc-rockchip.ko"
BR2_THUNDERBOOT_SIMPLIFY_USB=y
BR2_THUNDERBOOT_USB_ADBD=y
# BR2_PACKAGE_RKSCRIPT is reset to default
```

## configs/rockchip_rv1126_trailcamera_defconfig
```kconfig
#include "base/tiny.config"
#include "chips/rv1126_rv1109_arm.config"
#include "camera.config"
BR2_PACKAGE_CAMERA_ENGINE=
BR2_PACKAGE_CAMERA_ENGINE_RKAIQ_FAKE_CAMERA_IQFILE="os04c10_DW-RV04C_2G2P650IR-F21.xml"
BR2_PACKAGE_CAMERA_ENGINE_RKAIQ_IQFILE="os04c10_DW-RV04C_2G2P650IR-F21.xml"
BR2_PACKAGE_CAMERA_ENGINE_RKAIQ_IQFILE_USE_BIN=y
BR2_PACKAGE_CVR_APP=y
BR2_PACKAGE_DRM_DISPLAY_OUTPUT=y
BR2_PACKAGE_E2FSPROGS=
BR2_PACKAGE_E2FSPROGS_RESIZE2FS=
BR2_PACKAGE_FREETYPE=y
# BR2_PACKAGE_IFUPDOWN_SCRIPTS is not set
BR2_PACKAGE_LIBGLIB2=y
BR2_PACKAGE_LIBPNG=y
# BR2_PACKAGE_MINIGUI_SOFTWARE_SCALE is not set
BR2_PACKAGE_RKADK_ROCKIT=y
BR2_PACKAGE_RKMEDIA_ALSA=y
BR2_PACKAGE_RKMEDIA_ALSA_CAPTURE=y
BR2_PACKAGE_RKMEDIA_ALSA_PLAYBACK=y
BR2_PACKAGE_RKMEDIA_AUDIO_CODEC=y
BR2_PACKAGE_RKMEDIA_AUDIO_DECODER=y
BR2_PACKAGE_RKMEDIA_AUDIO_ENCODER=y
BR2_PACKAGE_RKMEDIA_MPP=y
BR2_PACKAGE_RKMEDIA_RKRGA=y
BR2_PACKAGE_RKMEDIA_USE_AIQ=y
BR2_PACKAGE_RKMEDIA_V4L2_CAPTURE=y
BR2_PACKAGE_THUNDERBOOT=y
BR2_PACKAGE_THUNDERBOOT_USE_EUDEV=y
BR2_ROOTFS_OVERLAY="board/rockchip/common/tinyrootfs/overlay board/rockchip/rv1126_rv1109/fs-overlay-trailcamera"
BR2_TARGET_GENERIC_ISSUE="Welcome to Battery EVB"
BR2_TARGET_GENERIC_ROOT_PASSWD=
BR2_TARGET_ROOTFS_CPIO=
BR2_TARGET_ROOTFS_CPIO_GZIP=
BR2_TARGET_ROOTFS_SQUASHFS=
BR2_THUNDERBOOT_INSTALL_MODULES="dw_mmc-rockchip.ko"
BR2_THUNDERBOOT_SIMPLIFY_USB=y
BR2_THUNDERBOOT_USB_ADBD=y
BR2_PACKAGE_RKSCRIPT=
```

## package/glibc/Config.in
```kconfig
if BR2_TOOLCHAIN_BUILDROOT_GLIBC

comment "Glibc Options"

config BR2_PACKAGE_GLIBC
	bool
	default y
	select BR2_PACKAGE_LINUX_HEADERS
	select BR2_TOOLCHAIN_HAS_SSP if BR2_PACKAGE_HOST_BINUTILS_SUPPORTS_CFI
	help
	  https://www.gnu.org/software/libc/

choice
        prompt "glibc version"
        default BR2_PACKAGE_GLIBC_2_34

config BR2_PACKAGE_GLIBC_2_34
        bool "glibc 2.34"

config BR2_PACKAGE_GLIBC_2_29
        bool "glibc 2.29"

endchoice

config BR2_PACKAGE_GLIBC_UTILS
	bool "Install glibc utilities"
	help
	  Enabling this option will compile and install the getconf,
	  ldconfig, ldd and locale glibc utilities for the target.

config BR2_PACKAGE_GLIBC_GEN_LD_CACHE
	bool "glibc gen ld.so.cache"
	default y
	select BR2_PACKAGE_HOST_QEMU
	select BR2_PACKAGE_HOST_QEMU_LINUX_USER_MODE

endif # BR2_TOOLCHAIN_BUILDROOT_GLIBC
```

## package/gstreamer1/gst1-plugins-good/Config.in
```kconfig
if BR2_PACKAGE_GSTREAMER1_14
source "package/gstreamer1/gst1-plugins-good/1.14.4/Config.in"
endif

if BR2_PACKAGE_GSTREAMER1_18
source "package/gstreamer1/gst1-plugins-good/1.18.5/Config.in"
endif

if BR2_PACKAGE_GSTREAMER1_20
source "package/gstreamer1/gst1-plugins-good/1.20.0/Config.in"
endif
```

## package/lvgl/Config.in
```kconfig
# LVGL - Light and Versatile Graphics Library
source "package/lvgl/lvgl/Config.in"

if BR2_PACKAGE_LVGL
source "package/lvgl/lv_drivers/Config.in"
source "package/lvgl/lvgl_demo/Config.in"
endif
```

## package/lvgl/lv_drivers/Config.in
```kconfig
config BR2_PACKAGE_LV_DRIVERS
	bool "lv-drivers"
	default n
	help
	  The concrete implementation of hardware

if BR2_PACKAGE_LV_DRIVERS
	config BR2_PACKAGE_LV_DRIVERS_USE_SDL_GPU
		bool
		default y if BR2_PACKAGE_LVGL_USE_SDL
		help
		  Enbale sdl renderer

	config BR2_PACKAGE_LV_DRIVERS_USE_DRM
		bool
		default y if BR2_PACKAGE_LVGL_USE_DRM
		select BR2_PACKAGE_LIBDRM
		help
		  Enbale drm renderer

	config BR2_PACKAGE_LV_DRIVERS_USE_RGA
		bool "Use RGA in DRM rendering"
		default n
		depends on BR2_PACKAGE_ROCKCHIP_RGA
		depends on BR2_PACKAGE_LV_DRIVERS_USE_DRM
		help
		  Enbale RGA to copy image

endif
```

## package/lvgl/lvgl/Config.in
```kconfig
menuconfig BR2_PACKAGE_LVGL
	bool "LVGL"
	select BR2_PACKAGE_FREETYPE
	default n
	help
	  Light and Versatile Graphics Library

if BR2_PACKAGE_LVGL
	config BR2_PACKAGE_LVGL_COLOR_DEPTH
		int "Color Depth (1, 8, 16, 32)"
		default 32
		range 1 32
		help
		  LVGL color depth
		  1  => 1BPP
		  8  => RGB332
		  16 => RGB565
		  32 => ARGB8888

	config BR2_PACKAGE_LVGL_COLOR_16_SWAP
		bool "Color 16 Swap"
		default y
		depends on BR2_PACKAGE_LVGL_COLOR_DEPTH=16
		help
		  Swap the 2 bytes of RGB565 color.
		  Useful if the display has an 8-bit interface.
		  (e.g. SPI)

	config BR2_PACKAGE_LVGL_DEMOS
		bool
		default y
		help
		  Enable lvgl official demos

	choice
		prompt "LVGL backport select"
		config BR2_PACKAGE_LVGL_USE_SDL
			bool "sdl"
			select BR2_PACKAGE_SDL2
			help
			  Use SDL to draw and render

		config BR2_PACKAGE_LVGL_USE_DRM
			bool "drm"
			select BR2_PACKAGE_LIBDRM
			help
			  Use CPU to draw and DRM to render

	endchoice

endif
```
