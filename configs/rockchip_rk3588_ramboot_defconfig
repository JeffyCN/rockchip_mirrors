## configs/rockchip_rk3588_ramboot_defconfig
```kconfig
#include "base.config"
#include "rk3588_aarch64.config"
#include "tee_aarch64_v2.config"

# BR2_PACKAGE_RKSCRIPT is not set
BR2_ROOTFS_OVERLAY="board/rockchip/common/security-ramdisk-overlay/"
BR2_PACKAGE_LUKSMETA=y
BR2_PACKAGE_LVM2_STANDARD_INSTALL=y
BR2_PACKAGE_E2FSPROGS=y
BR2_PACKAGE_E2FSPROGS_RESIZE2FS=y
```

## configs/rockchip_rk3588_x11_defconfig
```kconfig
#include "base.config"
#include "base_extra.config"
#include "rk3588_aarch64.config"
#include "audio.config"
#include "audio_gst.config"
#include "video_mpp.config"
#include "video_gst.config"
#include "gpu.config"
BR2_PACKAGE_MESA3D=y
BR2_PACKAGE_MESA3D_OSMESA_GALLIUM=y
BR2_PACKAGE_MESA3D_OPENGL_GLX=y
BR2_PACKAGE_XORG7=y
BR2_PACKAGE_XSERVER_XORG_SERVER=y
BR2_RELRO_NONE=y
BR2_PACKAGE_GLIBC_2_29=y
BR2_GCC_VERSION_10_X=y
```

## configs/rockchip_rv1126_evb_spi_nor_tb_defconfig
```kconfig
#include "base/tiny.config"
#include "chips/rv1126_rv1109_arm.config"
#include "camera.config"
BR2_PACKAGE_CAMERA_ENGINE=
BR2_PACKAGE_CAMERA_ENGINE_RKAIQ_IQFILE="os04a10_CMK-OT1607-FV1_M12-40IRC-4MP-F16.xml"
BR2_PACKAGE_CAMERA_ENGINE_RKAIQ_IQFILE_USE_BIN=y
BR2_PACKAGE_DRM_DISPLAY_OUTPUT=y
BR2_PACKAGE_E2FSPROGS=
BR2_PACKAGE_E2FSPROGS_RESIZE2FS=
BR2_PACKAGE_EXPAT=y
# BR2_PACKAGE_IFUPDOWN_SCRIPTS is not set
BR2_PACKAGE_ISP2_IPC=y
BR2_PACKAGE_JSON_C=y
BR2_PACKAGE_LIBDRM_INSTALL_TESTS=y
BR2_PACKAGE_LIBGLIB2=y
BR2_PACKAGE_MEDIASERVE_CONFIG="evb_tb.conf"
# BR2_PACKAGE_MEDIASERVE_DBUS is not set
BR2_PACKAGE_MEDIASERVE_LINKAPI=y
# BR2_PACKAGE_MEDIASERVE_MINILOGGER is not set
BR2_PACKAGE_MEDIASERVER=y
BR2_PACKAGE_MEDIASERVE_TB=y
# BR2_PACKAGE_MINIGUI_SOFTWARE_SCALE is not set
BR2_PACKAGE_RKMEDIA_ALSA=y
BR2_PACKAGE_RKMEDIA_ALSA_CAPTURE=y
BR2_PACKAGE_RKMEDIA_ALSA_PLAYBACK=y
BR2_PACKAGE_RKMEDIA_AUDIO_ALGORITHM=y
BR2_PACKAGE_RKMEDIA_AUDIO_CODEC=y
BR2_PACKAGE_RKMEDIA_AUDIO_DECODER=y
BR2_PACKAGE_RKMEDIA_AUDIO_ENCODER=y
BR2_PACKAGE_RKMEDIA_LIVE555=y
BR2_PACKAGE_RKMEDIA_MPP=y
# BR2_PACKAGE_RKMEDIA_MPP_DECODER is not set
BR2_PACKAGE_RKMEDIA_RKRGA=y
BR2_PACKAGE_RKMEDIA_RTSP_SERVER=y
BR2_PACKAGE_RKMEDIA_RTSP_SERVER_H264=y
BR2_PACKAGE_RKMEDIA_USE_AIQ=y
BR2_PACKAGE_RKMEDIA_V4L2_CAPTURE=y
BR2_PACKAGE_THUNDERBOOT=y
BR2_ROOTFS_OVERLAY="board/rockchip/common/tinyrootfs/overlay board/rockchip/rv1126_rv1109/fs-overlay-evb-tb"
BR2_TARGET_GENERIC_ISSUE="Welcome to RV1126 tinyrootfs"
BR2_TARGET_ROOTFS_CPIO=
BR2_TARGET_ROOTFS_CPIO_GZIP=
BR2_TARGET_ROOTFS_SQUASHFS=
BR2_THUNDERBOOT_ETH=y
BR2_THUNDERBOOT_SIMPLIFY_USB=y
BR2_THUNDERBOOT_SOUND=y
BR2_THUNDERBOOT_USB_ADBD=y
```

## configs/rockchip_rv1126_robot_defconfig
```kconfig
#include "base/base.config"
#include "chips/rv1126_rv1109_arm.config"
#include "multimedia/audio.config"
#include "multimedia/camera.config"
#include "multimedia/mpp.config"
#include "wifibt/wireless.config"
#include "debug.config"
#include "update_engine.config"
BR2_PACKAGE_CAMERA_ENGINE_RKAIQ_IQFILE="os04a10_CMK-OT1607-FV1_M12-40IRC-4MP-F16.xml"
BR2_PACKAGE_ISP2_IPC=y
BR2_PACKAGE_JSON_C=y
BR2_PACKAGE_JSON_FOR_MODERN_CPP=y
BR2_PACKAGE_RKMEDIA=y
BR2_PACKAGE_RKMEDIA_ALSA=y
BR2_PACKAGE_RKMEDIA_ALSA_CAPTURE=y
BR2_PACKAGE_RKMEDIA_ALSA_PLAYBACK=y
BR2_PACKAGE_RKMEDIA_AUDIO_ALGORITHM=y
BR2_PACKAGE_RKMEDIA_AUDIO_CODEC=y
BR2_PACKAGE_RKMEDIA_AUDIO_DECODER=y
BR2_PACKAGE_RKMEDIA_AUDIO_ENCODER=y
BR2_PACKAGE_RKMEDIA_EXAMPLES=y
BR2_PACKAGE_RKMEDIA_LIVE555=y
BR2_PACKAGE_RKMEDIA_MOVE_DETECTION=y
BR2_PACKAGE_RKMEDIA_MPP=y
BR2_PACKAGE_RKMEDIA_RKNN=y
BR2_PACKAGE_RKMEDIA_RKRGA=y
BR2_PACKAGE_RKMEDIA_RTSP_SERVER=y
BR2_PACKAGE_RKMEDIA_RTSP_SERVER_H264=y
BR2_PACKAGE_RKMEDIA_RTSP_SERVER_H265=y
BR2_PACKAGE_RKMEDIA_USE_AIQ=y
BR2_PACKAGE_RKMEDIA_V4L2_CAPTURE=y
BR2_PACKAGE_UTIL_LINUX_MOUNT=
BR2_ROOTFS_OVERLAY+="board/rockchip/rv1126_rv1109/fs-overlay-robot/"
BR2_TARGET_ROOTFS_EXT2_MKFS_OPTIONS="-O ^64bit,^huge_file"
```

## configs/rockchip_rv1126_robot_recovery_defconfig
```kconfig
#include "base/base.config"
#include "base/recovery.config"
#include "chips/rv1126_rv1109_arm.config"
#include "update_engine.config"
# BR2_PACKAGE_RECOVERY_BOOTCONTROL is reset to default
BR2_PACKAGE_RECOVERY_RECOVERYBIN=y
BR2_TARGET_ROOTFS_EXT2_MKFS_OPTIONS="-O ^64bit,^huge_file"
```

## configs/rockchip_rv1126_rv1109_cvr_defconfig
```kconfig
#include "base/base.config"
#include "chips/rv1126_rv1109_arm.config"
#include "multimedia/audio.config"
#include "multimedia/camera.config"
#include "multimedia/mpp.config"
#include "wifibt/bt.config"
#include "wifibt/wireless.config"
#include "debug.config"
#include "update_engine.config"
BR2_PACKAGE_AVAHI=y
BR2_PACKAGE_AVAHI_DAEMON=y
BR2_PACKAGE_AVAHI_LIBDNSSD_COMPATIBILITY=y
BR2_PACKAGE_CAMERA_ENGINE_RKAIQ_IQFILE="os04a10_CMK-OT1607-FV1_M12-40IRC-4MP-F16.xml imx335_MTV4-IR-E-P_40IRC-4MP-F16.xml imx415_YT10092_IR0147-36IRC-8M-F20.xml"
BR2_PACKAGE_CAMERA_ENGINE_RKAIQ_RKISP_DEMO=y
BR2_PACKAGE_CONNMAN=y
BR2_PACKAGE_CONNMAN_CLIENT=y
BR2_PACKAGE_CONNMAN_LOOPBACK=y
BR2_PACKAGE_CONNMAN_WIFI=y
BR2_PACKAGE_CVR_APP=y
BR2_PACKAGE_DBUS_GLIB=y
BR2_PACKAGE_DRM_DISPLAY_OUTPUT=y
BR2_PACKAGE_EXIV2=y
BR2_PACKAGE_FCGIWRAP=y
BR2_PACKAGE_FREETYPE=y
BR2_PACKAGE_JSON_FOR_MODERN_CPP=y
BR2_PACKAGE_LIBCGICC=y
BR2_PACKAGE_LVGL_CONF="lv_conf_rv1126_cvr.h"
# BR2_PACKAGE_MINIGUI_SOFTWARE_SCALE is not set
BR2_PACKAGE_MINILOGGER=y
BR2_PACKAGE_NGINX=y
BR2_PACKAGE_NGINX_DEBUG=y
BR2_PACKAGE_NGINX_HTTP_FLV_LIVE=y
BR2_PACKAGE_NGINX_HTTP_SSL_MODULE=y
# BR2_PACKAGE_NTP_NTPD is not set
BR2_PACKAGE_OEM=y
BR2_PACKAGE_OEM_PACKAGES="cvr_app"
BR2_PACKAGE_PCBA_ADB_TEST=y
BR2_PACKAGE_PIXMAN=y
BR2_PACKAGE_RKADK_ROCKIT=y
BR2_PACKAGE_RKMEDIA_ALSA=y
BR2_PACKAGE_RKMEDIA_ALSA_CAPTURE=y
BR2_PACKAGE_RKMEDIA_ALSA_PLAYBACK=y
BR2_PACKAGE_RKMEDIA_AUDIO_ALGORITHM=y
BR2_PACKAGE_RKMEDIA_AUDIO_CODEC=y
BR2_PACKAGE_RKMEDIA_AUDIO_DECODER=y
BR2_PACKAGE_RKMEDIA_AUDIO_ENCODER=y
BR2_PACKAGE_RKMEDIA_EXAMPLES=y
BR2_PACKAGE_RKMEDIA_LIVE555=y
BR2_PACKAGE_RKMEDIA_MOVE_DETECTION=y
BR2_PACKAGE_RKMEDIA_MPP=y
BR2_PACKAGE_RKMEDIA_OCCLUSION_DETECTION=y
BR2_PACKAGE_RKMEDIA_RKRGA=y
BR2_PACKAGE_RKMEDIA_RTSP_SERVER=y
BR2_PACKAGE_RKMEDIA_RTSP_SERVER_H264=y
BR2_PACKAGE_RKMEDIA_RTSP_SERVER_H265=y
BR2_PACKAGE_RKMEDIA_USE_AIQ=y
BR2_PACKAGE_RKMEDIA_V4L2_CAPTURE=y
BR2_PACKAGE_UTIL_LINUX_MOUNT=
BR2_ROOTFS_OVERLAY+="board/rockchip/rv1126_rv1109/fs-overlay-sysv/ board/rockchip/rv1126_rv1109/fs-overlay-cvr"
BR2_TARGET_GENERIC_ISSUE="Welcome to RV1126/RV1109 CVR Demo Buildroot"
```

## configs/rockchip_rv1126_rv1109_defconfig
```kconfig
#include "base/base.config"
#include "chips/rv1126_rv1109_arm.config"
#include "multimedia/audio.config"
#include "multimedia/camera.config"
#include "multimedia/mpp.config"
#include "wifibt/bt.config"
#include "wifibt/wireless.config"
#include "debug.config"
#include "update_engine.config"
BR2_PACKAGE_CAMERA_ENGINE_RKAIQ_IQFILE="os04a10_CMK-OT1607-FV1_M12-40IRC-4MP-F16.xml imx335_MTV4-IR-E-P_40IRC-4MP-F16.xml imx415_YT10092_IR0147-36IRC-8M-F20.xml"
BR2_PACKAGE_CAMERA_ENGINE_RKAIQ_RKISP_DEMO=y
BR2_PACKAGE_COMMON_ALGORITHM_RKAPPLUS=y
BR2_PACKAGE_DBUS_CPP=y
BR2_PACKAGE_DBUS_GLIB=y
BR2_PACKAGE_DRM_DISPLAY_OUTPUT=y
# BR2_PACKAGE_EUDEV_ENABLE_HWDB is not set
BR2_PACKAGE_FCGIWRAP=y
BR2_PACKAGE_GESFTPSERVER=
BR2_PACKAGE_IPCWEB_BACKEND=y
BR2_PACKAGE_IPCWEB_BACKEND_USE_RKIPC=y
BR2_PACKAGE_JSON_C=y
BR2_PACKAGE_LIBMAD=
# BR2_PACKAGE_MINIGUI_SOFTWARE_SCALE is not set
BR2_PACKAGE_NGINX=y
BR2_PACKAGE_NGINX_ADD_MODULES="../nginx-http-flv-live-v1.2.10"
BR2_PACKAGE_NGINX_DEBUG=y
BR2_PACKAGE_NGINX_HTTP_FLV_LIVE=y
BR2_PACKAGE_NGINX_HTTP_FLV_MODULE=y
BR2_PACKAGE_NGINX_HTTP_SSL_MODULE=y
# BR2_PACKAGE_NTP_NTPD is not set
BR2_PACKAGE_OEM=y
BR2_PACKAGE_OEM_PACKAGES="ipcweb-backend"
BR2_PACKAGE_PIXMAN=y
BR2_PACKAGE_RKFSMK=y
BR2_PACKAGE_RKIPC=y
BR2_PACKAGE_RKIPC_RV1126=y
BR2_PACKAGE_RKMEDIA_ALSA=y
BR2_PACKAGE_RKMEDIA_ALSA_CAPTURE=y
BR2_PACKAGE_RKMEDIA_ALSA_PLAYBACK=y
BR2_PACKAGE_RKMEDIA_AUDIO_ALGORITHM=y
BR2_PACKAGE_RKMEDIA_AUDIO_CODEC=y
BR2_PACKAGE_RKMEDIA_AUDIO_DECODER=y
BR2_PACKAGE_RKMEDIA_AUDIO_ENCODER=y
BR2_PACKAGE_RKMEDIA_EXAMPLES=y
BR2_PACKAGE_RKMEDIA_MOVE_DETECTION=y
BR2_PACKAGE_RKMEDIA_MPP=y
BR2_PACKAGE_RKMEDIA_OCCLUSION_DETECTION=y
BR2_PACKAGE_RKMEDIA_RKNN=y
BR2_PACKAGE_RKMEDIA_RKRGA=y
BR2_PACKAGE_RKMEDIA_ROCKX=y
BR2_PACKAGE_RKMEDIA_USE_AIQ=y
BR2_PACKAGE_RKMEDIA_V4L2_CAPTURE=y
BR2_PACKAGE_ROCKCHIP_MPP_TESTS=
BR2_PACKAGE_ROCKX_PERSON_DETECTION=y
BR2_PACKAGE_SQLITE=y
BR2_PACKAGE_UTIL_LINUX_MOUNT=
BR2_PACKAGE_VENDOR_STORAGE_LIBRARY=y
BR2_PACKAGE_WPA_SUPPLICANT_AP_SUPPORT=
BR2_PACKAGE_WPA_SUPPLICANT_AUTOSCAN=
BR2_PACKAGE_WPA_SUPPLICANT_CLI=
BR2_PACKAGE_WPA_SUPPLICANT_EAP=
BR2_PACKAGE_WPA_SUPPLICANT_PASSPHRASE=
BR2_PACKAGE_WPA_SUPPLICANT_WPA_CLIENT_SO=
BR2_ROOTFS_OVERLAY+="board/rockchip/rv1126_rv1109/fs-overlay-sysv/"
```

## configs/rockchip_rv1126_rv1109_ramboot_uvcc_defconfig
```kconfig
#include "base/base.config"
#include "chips/rv1126_rv1109_arm.config"
#include "multimedia/camera.config"
#include "multimedia/mpp.config"
BR2_PACKAGE_CALLFUNIPC=y
BR2_PACKAGE_CAMERA_ENGINE_RKAIQ_IQFILE="os04a10_CMK-OT1607-FV1_M12-40IRC-4MP-F16.xml"
BR2_PACKAGE_DBUS_GLIB=y
BR2_PACKAGE_GDB=y
BR2_PACKAGE_GDB_DEBUGGER=y
BR2_PACKAGE_INPUT_EVENT_DAEMON=
BR2_PACKAGE_ISP2_IPC=y
BR2_PACKAGE_LIBIPCPROTOCOL=y
BR2_PACKAGE_LIBV4L=
BR2_PACKAGE_MEDIASERVER=y
BR2_PACKAGE_MEDIASERVE_SHM_SERVER=y
BR2_PACKAGE_PM_UTILS=
BR2_PACKAGE_RKMEDIA_MPP=y
BR2_PACKAGE_RKMEDIA_RKRGA=y
BR2_PACKAGE_RKMEDIA_ROCKX=y
BR2_PACKAGE_RKMEDIA_V4L2_CAPTURE=y
BR2_PACKAGE_RKNPU_USE_MINI_DRIVER=y
BR2_PACKAGE_ROCKCHIP_MPP=
BR2_PACKAGE_ROCKCHIP_MPP_ALLOCATOR_DRM=
BR2_PACKAGE_ROCKCHIP_RGA=
BR2_PACKAGE_SMART_DISPLAY_SERVICE=y
BR2_PACKAGE_UPDATE=
BR2_PACKAGE_USBMOUNT=
BR2_PACKAGE_UTIL_LINUX_MOUNT=
BR2_PACKAGE_UVC_APP=y
BR2_PACKAGE_VENDOR_STORAGE=
BR2_ROOTFS_OVERLAY+="board/rockchip/rv1126_rv1109/fs-overlay-ramboot-uvc/"
BR2_ROOTFS_POST_BUILD_SCRIPT+="board/rockchip/rv1126_rv1109/post-build-ramboot.sh"
```

## configs/rockchip_rv1126_rv1109_recovery_defconfig
```kconfig
#include "base/base.config"
#include "chips/rv1126_rv1109_arm.config"
#include "base/recovery.config"
#include "update_engine.config"
BR2_PACKAGE_RECOVERY_BOOTCONTROL=
BR2_PACKAGE_RECOVERY_RECOVERYBIN=y
```

## configs/rockchip_rv1126_rv1109_sl_defconfig
```kconfig
#include "base/base.config"
#include "chips/rv1126_rv1109_arm.config"
#include "fs/vfat.config"
#include "multimedia/camera.config"
#include "multimedia/mpp.config"
#include "debug.config"
BR2_PACKAGE_CAMERA_ENGINE=
BR2_PACKAGE_CAMERA_ENGINE_RKAIQ_IQFILE="ov02k10_ORCF-0249-00-PD-V1_xuye.xml"
BR2_PACKAGE_GDB=y
BR2_PACKAGE_GDB_DEBUGGER=y
BR2_PACKAGE_LIBV4L=
BR2_PACKAGE_RKNPU_USE_MINI_DRIVER=y
BR2_PACKAGE_RK_OEM=y
BR2_PACKAGE_RK_OEM_RESOURCE_DIR="$(TOPDIR)/../device/rockchip/oem/oem_empty"
BR2_PACKAGE_RKSL=y
BR2_PACKAGE_ROCKCHIP_MPP=
BR2_PACKAGE_ROCKCHIP_RGA=
BR2_PACKAGE_ROCKCHIP_UTILS=y
BR2_ROOTFS_OVERLAY+="board/rockchip/rv1126_rv1109/fs-overlay-sl/"
```

## configs/rockchip_rv1126_rv1109_spi_nand_defconfig
```kconfig
#include "base/base.config"
#include "chips/rv1126_rv1109_arm.config"
#include "fs/ubifs.config"
#include "multimedia/audio.config"
#include "multimedia/camera.config"
#include "multimedia/mpp.config"
#include "wifibt/wireless.config"
#include "update_engine.config"
BR2_PACKAGE_CALLFUNIPC=y
BR2_PACKAGE_CAMERA_ENGINE_RKAIQ_IQFILE="os04a10_CMK-OT1607-FV1_M12-40IRC-4MP-F16.xml"
BR2_PACKAGE_CAMERA_ENGINE_RKAIQ_RKISP_DEMO=y
BR2_PACKAGE_CONNMAN=y
BR2_PACKAGE_CONNMAN_CLIENT=y
BR2_PACKAGE_CONNMAN_LOOPBACK=y
BR2_PACKAGE_CONNMAN_WIFI=y
BR2_PACKAGE_DBSERVER=y
BR2_PACKAGE_DBUS_GLIB=y
BR2_PACKAGE_DRM_DISPLAY_OUTPUT=y
BR2_PACKAGE_FCGIWRAP=y
# BR2_PACKAGE_INPUT_EVENT_DAEMON is reset to default
BR2_PACKAGE_IO=y
BR2_PACKAGE_IPC_DAEMON=y
BR2_PACKAGE_IPCWEB_BACKEND=y
BR2_PACKAGE_ISP2_IPC=y
BR2_PACKAGE_ISP2_IPC_DBSERVER=y
BR2_PACKAGE_ISP2_IPC_DBUS=y
BR2_PACKAGE_ISP2_IPC_MINILOGGER=y
BR2_PACKAGE_MEDIASERVE_EXIV2_FEATURE=y
BR2_PACKAGE_MEDIASERVE_OSD_SERVER=y
BR2_PACKAGE_MEDIASERVER=y
# BR2_PACKAGE_MEDIASERVE_USE_ROCKFACE_RECOGNIZE is not set
# BR2_PACKAGE_MEDIASERVE_USE_ROCKX is not set
# BR2_PACKAGE_MINIGUI_SOFTWARE_SCALE is not set
BR2_PACKAGE_NETSERVER=y
BR2_PACKAGE_NGINX=y
BR2_PACKAGE_NGINX_DEBUG=y
BR2_PACKAGE_NGINX_HTTP_FLV_LIVE=y
BR2_PACKAGE_NGINX_HTTP_SSL_MODULE=y
# BR2_PACKAGE_NTP_NTPD is not set
# BR2_PACKAGE_PM_UTILS is reset to default
BR2_PACKAGE_RKMEDIA_ALSA=y
BR2_PACKAGE_RKMEDIA_ALSA_CAPTURE=y
BR2_PACKAGE_RKMEDIA_ALSA_PLAYBACK=y
BR2_PACKAGE_RKMEDIA_AUDIO_ALGORITHM=y
BR2_PACKAGE_RKMEDIA_AUDIO_CODEC=y
BR2_PACKAGE_RKMEDIA_AUDIO_DECODER=y
BR2_PACKAGE_RKMEDIA_AUDIO_ENCODER=y
BR2_PACKAGE_RKMEDIA_LIVE555=y
BR2_PACKAGE_RKMEDIA_MOVE_DETECTION=y
BR2_PACKAGE_RKMEDIA_MPP=y
BR2_PACKAGE_RKMEDIA_OCCLUSION_DETECTION=y
BR2_PACKAGE_RKMEDIA_RKRGA=y
BR2_PACKAGE_RKMEDIA_RTSP_SERVER=y
BR2_PACKAGE_RKMEDIA_RTSP_SERVER_H264=y
BR2_PACKAGE_RKMEDIA_RTSP_SERVER_H265=y
BR2_PACKAGE_RKMEDIA_USE_AIQ=y
BR2_PACKAGE_RKMEDIA_V4L2_CAPTURE=y
BR2_PACKAGE_RKNPU_USE_MINI_DRIVER=y
BR2_PACKAGE_RKNPU_USE_RKNN_API=y
BR2_PACKAGE_SQLITE_ENABLE_FTS3=y
BR2_PACKAGE_SQLITE_ENABLE_JSON1=y
BR2_PACKAGE_SQLITE_ENABLE_UNLOCK_NOTIFY=y
BR2_PACKAGE_SQLITE_SECURE_DELETE=y
BR2_PACKAGE_SQLITE_STAT4=y
BR2_PACKAGE_STORAGE_MANAGER=y
# BR2_PACKAGE_UTIL_LINUX_MOUNT is reset to default
BR2_ROOTFS_OVERLAY+="board/rockchip/rv1126_rv1109/fs-overlay-sysv/"
BR2_TARGET_ROOTFS_SQUASHFS4_XZ=y
BR2_TARGET_ROOTFS_UBI_SQUASHFS=y
BR2_TARGET_TZ_INFO=y
```

## configs/rockchip_rv1126_rv1109_spi_nand_recovery_defconfig
```kconfig
#include "base/base.config"
#include "base/recovery.config"
#include "chips/rv1126_rv1109_arm.config"
#include "fs/ubifs.config"
#include "update_engine.config"
BR2_PACKAGE_RECOVERY_BOOTCONTROL=
BR2_PACKAGE_RECOVERY_RECOVERYBIN=y
```
