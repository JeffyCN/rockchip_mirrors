## configs/rockchip_rk3308_32_release_defconfig
```kconfig
#include "base/common.config"
#include "chips/rk3308_arm.config"
BR2_GCC_ENABLE_OPENMP=y
BR2_JLEVEL=24
BR2_PACKAGE_ALSA_LADSPA=y
BR2_PACKAGE_ALSA_PLUGINS=y
BR2_PACKAGE_ALSA_UTILS=y
BR2_PACKAGE_ALSA_UTILS_ACONNECT=y
BR2_PACKAGE_ALSA_UTILS_ALSACONF=y
BR2_PACKAGE_ALSA_UTILS_AMIXER=y
BR2_PACKAGE_ALSA_UTILS_APLAY=y
BR2_PACKAGE_ALSA_UTILS_SPEAKER_TEST=y
BR2_PACKAGE_ANDROID_TOOLS=y
BR2_PACKAGE_BLUEZ5_UTILS=y
BR2_PACKAGE_DEVICEIO=y
BR2_PACKAGE_DHCPCD=y
BR2_PACKAGE_DNSMASQ=y
# BR2_PACKAGE_DNSMASQ_TFTP is not set
BR2_PACKAGE_EQ_DRC_PROCESS=y
BR2_PACKAGE_GST1_PLUGINS_BASE_PLUGIN_ALSA=y
# BR2_PACKAGE_GST1_PLUGINS_BASE_PLUGIN_VIDEOSCALE is not set
BR2_PACKAGE_GST1_PLUGINS_GOOD=y
BR2_PACKAGE_GST1_PLUGINS_GOOD_PLUGIN_AUDIOPARSERS=y
BR2_PACKAGE_GST1_PLUGINS_GOOD_PLUGIN_AUTODETECT=y
# BR2_PACKAGE_GST1_PLUGINS_GOOD_PLUGIN_AVI is not set
BR2_PACKAGE_GST1_PLUGINS_GOOD_PLUGIN_ID3DEMUX=y
# BR2_PACKAGE_GST1_PLUGINS_GOOD_PLUGIN_ISOMP4 is not set
BR2_PACKAGE_GST1_PLUGINS_GOOD_PLUGIN_MPG123=y
BR2_PACKAGE_GST1_PLUGINS_UGLY=y
BR2_PACKAGE_GSTREAMER1=y
# BR2_PACKAGE_GSTREAMER1_GST_DEBUG is not set
# BR2_PACKAGE_GSTREAMER1_INSTALL_TOOLS is not set
# BR2_PACKAGE_GSTREAMER1_PARSE is not set
# BR2_PACKAGE_GSTREAMER1_TRACE is not set
BR2_PACKAGE_HOSTAPD=y
# BR2_PACKAGE_HOSTAPD_ACS is not set
BR2_PACKAGE_HOST_GDB=y
BR2_PACKAGE_HOST_VBOOT_UTILS=y
# BR2_PACKAGE_IFUPDOWN_SCRIPTS is not set
BR2_PACKAGE_INPUT_EVENT_DAEMON=y
BR2_PACKAGE_IO=y
BR2_PACKAGE_MMC_UTILS=y
BR2_PACKAGE_RK3308=
BR2_PACKAGE_RKSCRIPT=y
BR2_PACKAGE_SOFTAPSERVER=y
BR2_PACKAGE_TINYALSA=y
BR2_PACKAGE_UPDATE=y
BR2_PACKAGE_USBMOUNT=y
BR2_PACKAGE_UTIL_LINUX_RFKILL=y
BR2_PACKAGE_VENDOR_STORAGE=y
BR2_PACKAGE_WIFIAUTOSETUP=y
BR2_PACKAGE_WPA_SUPPLICANT=y
BR2_PACKAGE_WPA_SUPPLICANT_AUTOSCAN=y
BR2_PACKAGE_WPA_SUPPLICANT_CLI=y
BR2_PACKAGE_WPA_SUPPLICANT_WPA_CLIENT_SO=y
BR2_ROOTFS_DEVICE_CREATION_DYNAMIC_EUDEV=y
BR2_ROOTFS_OVERLAY="board/rockchip/rk3308/fs-overlay"
# BR2_TARGET_ENABLE_ROOT_LOGIN is not set
BR2_TARGET_GENERIC_HOSTNAME="rockchip"
BR2_TARGET_GENERIC_ISSUE="Welcome to Rockchip"
BR2_TARGET_LOCALTIME="Asia/Shanghai"
BR2_TARGET_ROOTFS_CPIO=
BR2_TARGET_ROOTFS_CPIO_GZIP=
BR2_TARGET_ROOTFS_EXT2=y
BR2_TARGET_ROOTFS_EXT2_2r0=y
BR2_TARGET_ROOTFS_EXT2_SIZE="128M"
# BR2_TARGET_ROOTFS_TAR is not set
BR2_TARGET_TZ_INFO=y
BR2_TOOLCHAIN_BUILDROOT_VENDOR="rockchip"
```

## configs/rockchip_rk3308_64_dueros_defconfig
```kconfig
#include "base/common.config"
#include "chips/rk3308_aarch64.config"
# BR2_COMPILER_PARANOID_UNSAFE_PATH is not set
BR2_GCC_ENABLE_OPENMP=y
BR2_PACKAGE_ALSA_LADSPA=y
BR2_PACKAGE_ALSA_PLUGINS=y
BR2_PACKAGE_ALSA_UTILS=y
BR2_PACKAGE_ALSA_UTILS_ACONNECT=y
BR2_PACKAGE_ALSA_UTILS_ALSACONF=y
BR2_PACKAGE_ALSA_UTILS_AMIXER=y
BR2_PACKAGE_ALSA_UTILS_APLAY=y
BR2_PACKAGE_ALSA_UTILS_SPEAKER_TEST=y
BR2_PACKAGE_ANDROID_TOOLS=y
BR2_PACKAGE_CA_CERTIFICATES=y
BR2_PACKAGE_DHCPCD=y
BR2_PACKAGE_DNSMASQ=y
# BR2_PACKAGE_DNSMASQ_TFTP is not set
BR2_PACKAGE_EQ_DRC_PROCESS=y
BR2_PACKAGE_HOSTAPD=y
# BR2_PACKAGE_HOSTAPD_ACS is not set
BR2_PACKAGE_HOST_SQUASHFS=y
BR2_PACKAGE_HOST_VBOOT_UTILS=y
# BR2_PACKAGE_IFUPDOWN_SCRIPTS is not set
BR2_PACKAGE_IW=y
BR2_PACKAGE_LRZSZ=y
BR2_PACKAGE_NTP=y
BR2_PACKAGE_NTP_NTPDATE=y
BR2_PACKAGE_RK3308=
BR2_PACKAGE_RKSCRIPT=y
BR2_PACKAGE_SOFTAP=y
BR2_PACKAGE_TINYALSA=y
BR2_PACKAGE_UPDATE=y
BR2_PACKAGE_USBMOUNT=y
BR2_PACKAGE_UTIL_LINUX_RFKILL=y
BR2_PACKAGE_WPA_SUPPLICANT=y
BR2_PACKAGE_WPA_SUPPLICANT_AUTOSCAN=y
BR2_PACKAGE_WPA_SUPPLICANT_CLI=y
BR2_PACKAGE_WPA_SUPPLICANT_WPA_CLIENT_SO=y
BR2_PACKAGE_WPA_SUPPLICANT_WPS=y
BR2_ROOTFS_DEVICE_CREATION_DYNAMIC_EUDEV=y
BR2_ROOTFS_OVERLAY="board/rockchip/rk3308/fs-overlay"
# BR2_TARGET_ENABLE_ROOT_LOGIN is not set
BR2_TARGET_GENERIC_HOSTNAME="rockchip"
BR2_TARGET_GENERIC_ISSUE="Welcome to Rockchip"
BR2_TARGET_LOCALTIME="Asia/Shanghai"
BR2_TARGET_ROOTFS_CPIO=
BR2_TARGET_ROOTFS_CPIO_GZIP=
BR2_TARGET_ROOTFS_EXT2=y
BR2_TARGET_ROOTFS_EXT2_2r0=y
BR2_TARGET_ROOTFS_EXT2_SIZE="128M"
# BR2_TARGET_ROOTFS_TAR is not set
BR2_TARGET_TZ_INFO=y
BR2_TOOLCHAIN_BUILDROOT_VENDOR="rockchip"
```

## configs/rockchip_rk3308_b_rkpartybox_defconfig
```kconfig
#include "base/base.config"
#include "chips/rk3308_aarch64.config"
#include "fs/vfat.config"
#include "multimedia/audio.config"
#include "wifibt/bt.config"
#include "wifibt/wireless.config"
#include "lvgl.config"
#include "tools/gdb.config"
#include "tools/test.config"
BR2_PACKAGE_COREUTILS=y
BR2_PACKAGE_EVTEST=y
BR2_PACKAGE_I2C_TOOLS=y
BR2_PACKAGE_IW=y
# BR2_PACKAGE_LVGL_DEMO is reset to default
# BR2_PACKAGE_PULSEAUDIO is reset to default
BR2_PACKAGE_RKPARTYBOX=y
BR2_PACKAGE_SPEEX=y
BR2_PACKAGE_STRACE=y
BR2_TARGET_GENERIC_HOSTNAME="rk3308_64"
```

## configs/rockchip_rk3308_b_rkpartybox_nodisp_defconfig
```kconfig
#include "base/base.config"
#include "chips/rk3308_aarch64.config"
#include "fs/vfat.config"
#include "wifibt/bt.config"
#include "wifibt/wireless.config"
#include "multimedia/audio.config"
#include "lvgl.config"
#include "tools/test.config"
# BR2_PACKAGE_PULSEAUDIO is not set
# BR2_PACKAGE_PULSEAUDIO_DAEMON is not set
# BR2_PACKAGE_RKWIFIBT_APP is not set
# BR2_PACKAGE_ROCKCHIP_TEST is not set
BR2_PACKAGE_COREUTILS=y
BR2_PACKAGE_EVTEST=y
BR2_PACKAGE_I2C_TOOLS=y
BR2_PACKAGE_IW=y
# BR2_PACKAGE_LVGL_DEMO is reset to default
# BR2_PACKAGE_PULSEAUDIO is reset to default
BR2_PACKAGE_RKPARTYBOX=y
BR2_PACKAGE_RK3308_CORE_BOARD=y
BR2_PACKAGE_SPEEX=y
BR2_PACKAGE_STRACE=y
BR2_TARGET_GENERIC_HOSTNAME="rk3308_64"
BR2_STRIP_EXCLUDE_FILES="rkpartybox librockit.so"
```

## configs/rockchip_rk3308_bs_32_release_defconfig
```kconfig
#include "chips/rk3308_arm.config"
#include "base/base.config"
#include "audio.config"
#include "bt.config"
#include "network.config"
#include "test.config"
#include "vfat.config"
BR2_PACKAGE_COREUTILS=y
BR2_PACKAGE_EVTEST=y
BR2_PACKAGE_I2C_TOOLS=y
BR2_PACKAGE_IO=y
BR2_PACKAGE_IW=y
BR2_PACKAGE_STRACE=y
BR2_TARGET_GENERIC_HOSTNAME="rk3308_32"
BR2_TARGET_GENERIC_ISSUE="Welcome to RK3308 Buildroot"
```

## configs/rockchip_rk3308_bs_release_defconfig
```kconfig
#include "rk3308_aarch64.config"
#include "base.config"
#include "base_extra.config"
#include "audio.config"
#include "bt.config"
#include "network.config"
#include "test.config"
BR2_CCACHE=y
BR2_TARGET_GENERIC_HOSTNAME="rk3308_64"
BR2_TARGET_GENERIC_ISSUE="Welcome to RK3308 Buildroot"
#EQ
BR2_PACKAGE_EQ_DRC_PROCESS=y
# base tools
BR2_PACKAGE_RECOVERY_USE_UPDATEENGINE=y
BR2_PACKAGE_RECOVERY_UPDATEENGINEBIN=y
# debug tools
BR2_PACKAGE_COREUTILS=y
BR2_PACKAGE_EVTEST=y
BR2_PACKAGE_IO=y
BR2_PACKAGE_I2C_TOOLS=y
BR2_PACKAGE_IW=y
BR2_PACKAGE_STRACE=y
```

## configs/rockchip_rk3308_h_32_release_defconfig
```kconfig
#include "chips/rk3308_arm.config"
#include "base/base.config"
#include "audio.config"
#include "network.config"
#include "test.config"
BR2_PACKAGE_COREUTILS=y
BR2_PACKAGE_DOSFSTOOLS=y
BR2_PACKAGE_DOSFSTOOLS_MKFS_FAT=y
BR2_PACKAGE_EVTEST=y
BR2_PACKAGE_I2C_TOOLS=y
BR2_PACKAGE_IO=y
BR2_PACKAGE_IW=y
BR2_PACKAGE_STRACE=y
BR2_PACKAGE_UPOWER=y
BR2_PACKAGE_UTIL_LINUX_MOUNT=
BR2_ROOTFS_MERGED_USR=
BR2_TARGET_GENERIC_HOSTNAME="rk3308h_32"
BR2_TARGET_GENERIC_ISSUE="Welcome to RK3308 Buildroot"
```

## configs/rockchip_rk3308_pcba_defconfig
```kconfig
#include "base/base.config"
#include "chips/rk3308_arm.config"
#include "fs/vfat.config"
#include "multimedia/audio.config"
#include "wifibt/bt.config"
#include "wifibt/wireless.config"
#include "debug.config"
BR2_PACKAGE_ALSA_LADSPA=y
BR2_PACKAGE_ALSA_UTILS_SPEAKER_TEST=y
BR2_PACKAGE_HOST_VBOOT_UTILS=y
BR2_PACKAGE_IPTABLES=y
BR2_PACKAGE_PCBA=y
BR2_PACKAGE_UTIL_LINUX_RFKILL=y
BR2_ROOTFS_OVERLAY+="board/rockchip/rk3308/fs-overlay-pcba"
BR2_TARGET_GENERIC_HOSTNAME="rockchip"
BR2_TARGET_GENERIC_ISSUE="Welcome to Rockchip"
```

## configs/rockchip_rk3308_ramboot_defconfig
```kconfig
#include "base/base.config"
#include "base/recovery.config"
#include "chips/rk3308_arm.config"
BR2_PACKAGE_LUKSMETA=y
BR2_ROOTFS_OVERLAY+="board/rockchip/common/security-ramdisk-overlay/"
```

## configs/rockchip_rk3308_recovery_defconfig
```kconfig
#include "base/base.config"
#include "base/recovery.config"
#include "chips/rk3308_arm.config"
BR2_PACKAGE_RECOVERY_NO_UI=y
```

## configs/rockchip_rk3308_robot64_defconfig
```kconfig
#include "base/base.config"
#include "chips/rk3308_aarch64.config"
#include "multimedia/audio.config"
#include "wifibt/wireless.config"
BR2_PACKAGE_COREUTILS=y
# BR2_PACKAGE_EUDEV_ENABLE_HWDB is not set
BR2_PACKAGE_EVTEST=y
# BR2_PACKAGE_INPUT_EVENT_DAEMON is reset to default
BR2_PACKAGE_IO=y
BR2_PACKAGE_IW=y
# BR2_PACKAGE_PM_UTILS is reset to default
BR2_PACKAGE_STRACE=y
# BR2_PACKAGE_UPDATE is reset to default
# BR2_PACKAGE_USBMOUNT is reset to default
# BR2_PACKAGE_UTIL_LINUX_MOUNT is reset to default
BR2_TARGET_GENERIC_HOSTNAME="rk3308_robot64"
BR2_TARGET_GENERIC_ISSUE="Welcome to RK3308 Buildroot For Robot"
```

## configs/rockchip_rk3308_robot_recovery_defconfig
```kconfig
#include "base/recovery.config"
#include "chips/rk3308_arm.config"
BR2_PACKAGE_ANDROID_TOOLS=y
BR2_PACKAGE_RECOVERY_NO_UI=y
BR2_PACKAGE_VENDOR_STORAGE=y
```

## configs/rockchip_rk3308_tiny_recovery_defconfig
```kconfig
#include "chips/rk3308_arm.config"
#include "base/tiny.config"

BR2_ROOTFS_POST_BUILD_SCRIPT+="board/rockchip/common/tinyrecovery/post-build-tinyrecovery.sh"
```

## configs/rockchip_rk3326_64_defconfig
```kconfig
#include "base/base.config"
#include "chips/rk3326_aarch64.config"
#include "fs/vfat.config"
#include "gpu/gpu.config"
#include "multimedia/audio.config"
#include "multimedia/camera.config"
#include "multimedia/gst/audio.config"
#include "multimedia/gst/camera.config"
#include "multimedia/gst/video.config"
#include "multimedia/mpp.config"
#include "wifibt/bt.config"
#include "wifibt/wireless.config"
#include "benchmark.config"
#include "debug.config"
#include "test.config"
#include "weston.config"
BR2_PACKAGE_SLT_GPU_LIGHT=y
BR2_ROOTFS_OVERLAY+="board/rockchip/rk3326/fs-overlay-64/"
BR2_TARGET_GENERIC_HOSTNAME="rk3326_64"
BR2_TARGET_GENERIC_ISSUE="Welcome to RK3326 Buildroot"
```

## configs/rockchip_rk3326_recovery_defconfig
```kconfig
#include "chips/rk3326_aarch64.config"
#include "base/base.config"
#include "base/recovery.config"
BR2_CCACHE=
BR2_PACKAGE_UPOWER=y
BR2_PACKAGE_UTIL_LINUX_MOUNT=
BR2_ROOTFS_MERGED_USR=
BR2_TARGET_GENERIC_ROOT_PASSWD=
```

## configs/rockchip_rk3326_robot64_defconfig
```kconfig
#include "base/base.config"
#include "chips/rk3326_aarch64.config"
#include "multimedia/audio.config"
#include "wifibt/wireless.config"
BR2_PACKAGE_COREUTILS=y
# BR2_PACKAGE_EUDEV_ENABLE_HWDB is not set
BR2_PACKAGE_EVTEST=y
BR2_PACKAGE_INPUT_EVENT_DAEMON=
BR2_PACKAGE_IO=y
BR2_PACKAGE_IW=y
BR2_PACKAGE_PM_UTILS=
BR2_PACKAGE_STRACE=y
BR2_PACKAGE_USBMOUNT=
BR2_PACKAGE_UTIL_LINUX_MOUNT=
BR2_TARGET_GENERIC_HOSTNAME="rk3326_robot64"
BR2_TARGET_GENERIC_ISSUE="Welcome to RK3326 Buildroot For Robot"
```

## configs/rockchip_rk3326_robot64_no_gpu_defconfig
```kconfig
#include "base/base.config"
#include "chips/rk3326_aarch64.config"
#include "fs/vfat.config"
#include "multimedia/audio.config"
#include "multimedia/camera.config"
#include "multimedia/mpp.config"
#include "wifibt/wireless.config"
#include "debug.config"
BR2_ROOTFS_OVERLAY+="board/rockchip/rk3326/fs-overlay-64/"
BR2_TARGET_GENERIC_HOSTNAME="rk3326_robot"
BR2_TARGET_GENERIC_ISSUE="Welcome to RK3326 Buildroot"
```

## configs/rockchip_rk3326_robot_recovery_defconfig
```kconfig
#include "base/recovery.config"
#include "chips/rk3326_aarch64.config"
BR2_PACKAGE_ANDROID_ADBD=y
BR2_PACKAGE_RECOVERY_NO_UI=y
BR2_PACKAGE_VENDOR_STORAGE=y
```

## configs/rockchip_rk3328_defconfig
```kconfig
#include "base/base.config"
#include "chips/rk3328_aarch64.config"
#include "fs/vfat.config"
#include "gpu/gpu.config"
#include "multimedia/audio.config"
#include "multimedia/camera.config"
#include "multimedia/gst/audio.config"
#include "multimedia/gst/camera.config"
#include "multimedia/gst/rtsp.config"
#include "multimedia/gst/video.config"
#include "multimedia/mpp.config"
#include "wifibt/bt.config"
#include "wifibt/wireless.config"
#include "benchmark.config"
#include "debug.config"
#include "test.config"
#include "weston.config"
BR2_PACKAGE_RKSCRIPT_DEFAULT_PCM="rockchiphdmi"
BR2_TARGET_GENERIC_HOSTNAME="rk3328"
BR2_TARGET_GENERIC_ISSUE="Welcome to RK3328 Buildroot"
```

## configs/rockchip_rk3328_recovery_defconfig
```kconfig
#include "chips/rk3328_aarch64.config"
#include "base/base.config"
#include "base/recovery.config"
BR2_PACKAGE_RECOVERY_NO_UI=y
```

## configs/rockchip_rk3358_32_defconfig
```kconfig
#include "chips/rk3326_arm.config"
#include "audio_gst.config"
#include "base/base.config"
#include "gpu.config"
#include "weston.config"
#include "powermanager.config"
#include "video_mpp.config"
#include "video_gst.config"
#include "audio.config"
#include "camera.config"
#include "camera_gst.config"
#include "test.config"
#include "debug.config"
#include "benchmark.config"
#include "network.config"
#include "bt.config"
#include "vfat.config"
BR2_TARGET_GENERIC_HOSTNAME="rk3358_32"
BR2_TARGET_GENERIC_ISSUE="Welcome to RK3358 Buildroot"
```

## configs/rockchip_rk3358j_yx_32_defconfig
```kconfig
#include "base/base.config"
#include "chips/rk3326_arm.config"
#include "yx.config"
BR2_PACKAGE_NTFS_3G_NTFSPROGS=
BR2_ROOTFS_OVERLAY+="board/rockchip/yx/fs-overlay/"
BR2_TARGET_GENERIC_HOSTNAME="rk3358_32"
```

## configs/rockchip_rk3399_defconfig
```kconfig
#include "chips/rk3399_aarch64.config"
#include "base/base.config"
#include "gpu.config"
#include "weston.config"
#include "video_mpp.config"
#include "video_gst.config"
#include "video_gst_rtsp.config"
#include "powermanager.config"
#include "audio.config"
#include "audio_gst.config"
#include "camera.config"
#include "camera_gst.config"
#include "test.config"
#include "debug.config"
#include "benchmark.config"
#include "network.config"
#include "bt.config"
#include "ntfs.config"
#include "exfat.config"
#include "vfat.config"
BR2_TARGET_GENERIC_HOSTNAME="rk3399"
BR2_TARGET_GENERIC_ISSUE="Welcome to RK3399 Buildroot"
```
