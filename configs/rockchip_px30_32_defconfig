## configs/rockchip_px30_32_defconfig
```kconfig
#include "base/base.config"
#include "chips/rk3326_arm.config"
#include "fs/vfat.config"
#include "gpu/gpu.config"
#include "multimedia/audio.config"
#include "multimedia/camera.config"
#include "multimedia/gst/audio.config"
#include "multimedia/gst/camera.config"
#include "multimedia/gst/video.config"
#include "multimedia/mpp.config"
#include "wifibt/bt.config"
#include "wifibt/wireless.config"
#include "benchmark.config"
#include "debug.config"
#include "test.config"
#include "weston.config"
BR2_PACKAGE_SLT_GPU_LIGHT=y
BR2_ROOTFS_OVERLAY+="board/rockchip/px30/fs-overlay-32/"
BR2_TARGET_GENERIC_HOSTNAME="px30_32"
BR2_TARGET_GENERIC_ISSUE="Welcome to PX30 Buildroot"
```

## configs/rockchip_px30_robot32_defconfig
```kconfig
#include "rk3326_arm.config"
#include "base.config"
#include "base_extra.config"
#include "gpu.config"
#include "video_mpp.config"
#include "audio.config"
#include "camera.config"
#include "debug.config"
#include "network.config"
BR2_TARGET_GENERIC_HOSTNAME="PX30_robot"
BR2_TARGET_GENERIC_ISSUE="Welcome to PX30 Buildroot"
BR2_ROOTFS_OVERLAY+="board/rockchip/px30/fs-overlay-32/"
```

## configs/rockchip_px30_robot64_no_gpu_defconfig
```kconfig
#include "base/base.config"
#include "chips/rk3326_aarch64.config"
#include "fs/vfat.config"
#include "multimedia/audio.config"
#include "multimedia/camera.config"
#include "multimedia/mpp.config"
#include "wifibt/wireless.config"
#include "debug.config"
BR2_ROOTFS_OVERLAY+="board/rockchip/px30/fs-overlay-64/"
BR2_TARGET_GENERIC_HOSTNAME="px30_robot"
```

## configs/rockchip_px3se_defconfig
```kconfig
#include "base/base.config"
#include "gpu.config"
#include "weston.config"
#include "video_mpp.config"
#include "video_gst.config"
#include "audio.config"
#include "camera.config"
#include "camera_gst.config"
#include "test.config"
#include "debug.config"
#include "benchmark.config"
#include "network.config"
#include "bt.config"
#include "chips/px3se_arm.config"
#include "vfat.config"
BR2_TARGET_GENERIC_HOSTNAME="px3se"
BR2_TARGET_GENERIC_ISSUE="Welcome to PX3se Buildroot"
```

## configs/rockchip_rk1806_ficial_gate_defconfig
```kconfig
#include "base/base.config"
#include "chips/rk1806_arm.config"
#include "fs/vfat.config"
#include "multimedia/audio.config"
#include "multimedia/camera.config"
#include "multimedia/mpp.config"
#include "wifibt/wireless.config"
#include "debug.config"
#include "webserver.config"
# BR2_PACKAGE_CAMERA_ENGINE_RKISP_3A_SERVICE is not set
BR2_PACKAGE_FICIAL_GATE=y
BR2_PACKAGE_MINIGUI_ENABLE_FREETYPE=y
BR2_PACKAGE_MINIGUI_ENABLE_RGA=y
# BR2_PACKAGE_MINIGUI_SOFTWARE_SCALE is not set
BR2_PACKAGE_RKFACIAL_USE_WEB_SERVER=y
BR2_ROOTFS_OVERLAY+="board/rockchip/rk1806/fs-overlay-sysv/"
BR2_TOOLCHAIN_GLIBC_GCONV_LIBS_COPY=y
BR2_TOOLCHAIN_GLIBC_GCONV_LIBS_LIST="GBK"
```

## configs/rockchip_rk1806_thunder_boot_defconfig
```kconfig
#include "base/base.config"
#include "chips/rk1806_arm.config"
#include "fs/vfat.config"
#include "multimedia/camera.config"
#include "debug.config"
BR2_PACKAGE_CAMERA_ENGINE=
BR2_PACKAGE_CAMERA_ENGINE_RKISP_3A_SPEEDUP_DIR_ETC=y
BR2_PACKAGE_CAMERA_ENGINE_RKISP_IQFILE="ps5268_default_default.xml"
BR2_PACKAGE_FACE_DETECT=y
BR2_PACKAGE_LIBDRM_INSTALL_TESTS=y
BR2_PACKAGE_RKNPU_USE_MINI_DRIVER=y
```

## configs/rockchip_rk1808-multi_defconfig
```kconfig
#include "base/base.config"
#include "chips/rk1808.config"
BR2_aarch64=y
BR2_cortex_a35=y
BR2_PACKAGE_ABOOTIMG=y
# BR2_PACKAGE_ANDROID_TOOLS is reset to default
# BR2_PACKAGE_E2FSPROGS is reset to default
# BR2_PACKAGE_INPUT_EVENT_DAEMON is reset to default
BR2_PACKAGE_IO=y
BR2_PACKAGE_LIBDRM_INSTALL_TESTS=y
BR2_PACKAGE_LIBUSB=y
BR2_PACKAGE_LIBV4L=y
BR2_PACKAGE_LIBV4L_UTILS=y
BR2_PACKAGE_LIBXML2=y
# BR2_PACKAGE_PM_UTILS is reset to default
BR2_PACKAGE_PROCRANK_LINUX=y
BR2_PACKAGE_RKNPU=y
BR2_PACKAGE_ROCKCHIP_RGA=y
# BR2_PACKAGE_UPDATE is reset to default
# BR2_PACKAGE_USBMOUNT is reset to default
# BR2_PACKAGE_UTIL_LINUX_MOUNT is reset to default
# BR2_PACKAGE_VENDOR_STORAGE is reset to default
BR2_ROOTFS_OVERLAY+="board/rockchip/rk1808_multi/fs-overlay-64/"
```

## configs/rockchip_rk1808_compute_stick_defconfig
```kconfig
#include "base/base.config"
#include "chips/rk1808_aarch64.config"
#include "fs/vfat.config"
#include "tools/common.config"
BR2_PACKAGE_RKNPU=y
BR2_PACKAGE_RKNPU_NTB=y
```

## configs/rockchip_rk1808_defconfig
```kconfig
#include "base/base.config"
#include "chips/rk1808_aarch64.config"
#include "fs/vfat.config"
#include "multimedia/audio.config"
#include "multimedia/camera.config"
#include "multimedia/gst/audio.config"
#include "multimedia/gst/camera.config"
#include "multimedia/gst/rtsp.config"
#include "multimedia/gst/video.config"
#include "multimedia/mpp.config"
#include "wifibt/bt.config"
#include "wifibt/wireless.config"
#include "debug.config"
#include "weston.config"
BR2_PACKAGE_MESA3D=y
BR2_PACKAGE_MESA3D_GALLIUM_DRIVER_SWRAST=y
BR2_PACKAGE_MESA3D_OPENGL_EGL=y
BR2_PACKAGE_MESA3D_OPENGL_ES=y
BR2_PACKAGE_MINIGUI_ENABLE_FREETYPE=y
BR2_PACKAGE_MINIGUI_ENABLE_RGA=y
BR2_PACKAGE_RKNN_DEMO=y
BR2_PACKAGE_ROCKCHIP_UTILS=y
BR2_PACKAGE_ROCKX=y
```

## configs/rockchip_rk3036_defconfig
```kconfig
#include "base/base.config"
#include "chips/rk3036_arm.config"
#include "fs/vfat.config"
#include "gpu/gpu.config"
#include "multimedia/audio.config"
#include "multimedia/gst/video.config"
#include "multimedia/mpp.config"
#include "wifibt/bt.config"
#include "wifibt/wireless.config"
#include "benchmark.config"
#include "debug.config"
#include "test.config"
#include "weston.config"
BR2_TARGET_GENERIC_HOSTNAME="rk3036"
BR2_TARGET_GENERIC_ISSUE="Welcome to RK3036 Buildroot"
```

## configs/rockchip_rk3126c_defconfig
```kconfig
#include "chips/rk312x_arm.config"
#include "base/base.config"
#include "gpu.config"
#include "weston.config"
#include "video_mpp.config"
#include "video_gst.config"
#include "audio.config"
#include "audio_gst.config"
#include "camera.config"
#include "camera_gst.config"
#include "network.config"
#include "ubifs.config"
#include "vfat.config"
BR2_TARGET_GENERIC_HOSTNAME="rk3126c"
BR2_TARGET_GENERIC_ISSUE="Welcome to RK3126C Buildroot"
```

## configs/rockchip_rk3128h_defconfig
```kconfig
#include "base/base.config"
#include "chips/rk3128h_arm.config"
#include "fs/vfat.config"
#include "gpu/gpu.config"
#include "multimedia/audio.config"
#include "multimedia/camera.config"
#include "multimedia/gst/video.config"
#include "multimedia/mpp.config"
#include "wifibt/bt.config"
#include "wifibt/wireless.config"
#include "benchmark.config"
#include "debug.config"
#include "test.config"
#include "weston.config"
BR2_TARGET_GENERIC_HOSTNAME="rk3128h"
BR2_TARGET_GENERIC_ISSUE="Welcome to RK3128H Buildroot"
```

## configs/rockchip_rk312x_defconfig
```kconfig
#include "chips/rk312x_arm.config"
#include "base/base.config"
#include "gpu.config"
#include "weston.config"
#include "video_mpp.config"
#include "video_gst.config"
#include "audio.config"
#include "audio_gst.config"
#include "camera.config"
#include "camera_gst.config"
#include "network.config"
#include "bt.config"
#include "vfat.config"
BR2_TARGET_GENERIC_HOSTNAME="rk312x"
BR2_TARGET_GENERIC_ISSUE="Welcome to RK312X Buildroot"
```

## configs/rockchip_rk3229_defconfig
```kconfig
#include "base/base.config"
#include "chips/rk3229_arm.config"
#include "fs/vfat.config"
#include "gpu/gpu.config"
#include "multimedia/audio.config"
#include "multimedia/camera.config"
#include "multimedia/gst/video.config"
#include "multimedia/mpp.config"
#include "wifibt/bt.config"
#include "wifibt/wireless.config"
#include "benchmark.config"
#include "debug.config"
#include "test.config"
#include "weston.config"
BR2_TARGET_GENERIC_HOSTNAME="rk3229"
BR2_TARGET_GENERIC_ISSUE="Welcome to RK3229 Buildroot"
```

## configs/rockchip_rk3288_4.19_defconfig
```kconfig
#include "rk3288_arm.config"
#include "base.config"
#include "base_extra.config"
#include "gpu.config"
#include "display.config"
#include "video_mpp.config"
#include "video_gst.config"
#include "audio.config"
#include "audio_gst.config"
#include "camera.config"
#include "camera_gst.config"
#include "test.config"
#include "debug.config"
#include "benchmark.config"
#include "wifi.config"
#include "network.config"
#include "bt.config"
#include "qt.config"
#include "qt_app.config"
#include "ntfs.config"
BR2_ROOTFS_OVERLAY="board/rockchip/rk3288/fs-overlay/"
BR2_TARGET_GENERIC_HOSTNAME="rk3288"
BR2_TARGET_GENERIC_ISSUE="Welcome to RK3288 Buildroot"
BR2_PACKAGE_RKWIFIBT_AP6335=y
BR2_PACKAGE_RKWIFIBT_BTUART="ttyS0"
BR2_GCC_VERSION_9_X=y
BR2_KERNEL_HEADERS_4_19=y
# TEMP modify to fix Server Kernel Version low than 4.19
# BR2_PACKAGE_GLIBC_GEN_LD_CACHE is not set
BR2_PACKAGE_HOST_QEMU=y
```
