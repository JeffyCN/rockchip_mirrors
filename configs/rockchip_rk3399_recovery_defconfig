## configs/rockchip_rk3399pro-npu-multi-cam_defconfig
```kconfig
#include "base/base.config"
#include "chips/rk3399pro_npu_aarch64.config"
#include "camera.config"
BR2_PACKAGE_ANDROID_TOOLS=
BR2_PACKAGE_E2FSPROGS=
BR2_PACKAGE_E2FSPROGS_RESIZE2FS=
BR2_PACKAGE_IO=y
BR2_PACKAGE_LIBDRM_INSTALL_TESTS=y
BR2_PACKAGE_LIBUSB=y
BR2_PACKAGE_LIBV4L=
BR2_PACKAGE_LIBV4L_UTILS=
BR2_PACKAGE_LIBXML2=y
BR2_PACKAGE_LRZSZ=y
BR2_PACKAGE_N4=y
BR2_PACKAGE_PROCRANK_LINUX=y
BR2_PACKAGE_RK3399PRO_NPU=
BR2_PACKAGE_RKNPU=y
BR2_PACKAGE_RKNPU_ACM=y
BR2_PACKAGE_RKNPU_PCIE=y
BR2_PACKAGE_ROCKCHIP_TEST=y
BR2_PACKAGE_UPDATE=
BR2_PACKAGE_USBMOUNT=
BR2_PACKAGE_UTIL_LINUX_MOUNT=
BR2_PACKAGE_VENDOR_STORAGE=
```

## configs/rockchip_rk3399pro-npu_defconfig
```kconfig
#include "chips/rk3399pro_npu_aarch64.config"
#include "base/base.config"
BR2_PACKAGE_E2FSPROGS=
BR2_PACKAGE_E2FSPROGS_RESIZE2FS=
BR2_PACKAGE_IO=y
BR2_PACKAGE_LIBUSB=y
BR2_PACKAGE_LIBXML2=y
BR2_PACKAGE_PM_UTILS=
BR2_PACKAGE_PROCRANK_LINUX=y
BR2_PACKAGE_RKNPU=y
BR2_PACKAGE_RKNPU_NTB=y
BR2_PACKAGE_ROCKCHIP_TEST=y
BR2_PACKAGE_UPDATE=
BR2_PACKAGE_USBMOUNT=
BR2_PACKAGE_UTIL_LINUX_MOUNT=
BR2_PACKAGE_VENDOR_STORAGE=
```

## configs/rockchip_rk3399pro_combine_defconfig
```kconfig
#include "chips/rk3399pro_aarch64.config"
#include "base/base.config"
#include "gpu.config"
#include "weston.config"
#include "video_mpp.config"
#include "video_gst.config"
#include "video_gst_rtsp.config"
#include "audio.config"
#include "audio_gst.config"
#include "camera.config"
#include "camera_gst.config"
#include "test.config"
#include "debug.config"
#include "benchmark.config"
#include "network.config"
#include "bt.config"
#include "ntfs.config"
#include "exfat.config"
#include "vfat.config"
#include "rknn_demo.conf"
BR2_PACKAGE_NPU_POWERCTRL_COMBINE=y
BR2_PACKAGE_RKNPU_FW=y
BR2_PACKAGE_RKNPU_PCIE=y
```

## configs/rockchip_rk3399pro_defconfig
```kconfig
#include "chips/rk3399pro_aarch64.config"
#include "base/base.config"
#include "gpu.config"
#include "weston.config"
#include "video_mpp.config"
#include "video_gst.config"
#include "video_gst_rtsp.config"
#include "powermanager.config"
#include "audio.config"
#include "audio_gst.config"
#include "camera.config"
#include "camera_gst.config"
#include "test.config"
#include "debug.config"
#include "benchmark.config"
#include "network.config"
#include "bt.config"
#include "ntfs.config"
#include "exfat.config"
#include "rknn_demo.conf"
BR2_CCACHE=
BR2_PACKAGE_DOSFSTOOLS=y
BR2_PACKAGE_DOSFSTOOLS_MKFS_FAT=y
BR2_PACKAGE_NPU_POWERCTRL=y
BR2_PACKAGE_RKNPU_FW=y
BR2_PACKAGE_UPOWER=y
BR2_ROOTFS_MERGED_USR=
BR2_TARGET_GENERIC_HOSTNAME="rk3399pro"
BR2_TARGET_GENERIC_ISSUE="Welcome to RK3399PRO Buildroot"
```

## configs/rockchip_rk3566_defconfig
```kconfig
#include "audio.config"
#include "audio_gst.config"
#include "base/base.config"
#include "benchmark.config"
#include "bt.config"
#include "camera.config"
#include "camera_gst.config"
#include "debug.config"
#include "debug2.config"
#include "weston.config"
#include "gpu.config"
#include "network.config"
#include "ntfs.config"
#include "exfat.config"
#include "video_mpp.config"
#include "video_gst.config"
#include "video_gst_rtsp.config"
#include "powermanager.config"
#include "chips/rk356x_aarch64.config"
#include "test.config"
BR2_CCACHE=
BR2_PACKAGE_DOSFSTOOLS=y
BR2_PACKAGE_DOSFSTOOLS_MKFS_FAT=y
BR2_PACKAGE_RKNPU2=y
BR2_PACKAGE_UPOWER=y
BR2_ROOTFS_MERGED_USR=
```

## configs/rockchip_rk3568_defconfig
```kconfig
# Architecture
#include "rk356x_aarch64.config"

# Filesystem
#include "base.config"
#include "base_extra.config"

# Audio
#include "audio.config"
#include "audio_gst.config"

# Camera
#include "camera.config"
#include "camera_gst.config"

# Display
#include "weston.config"

# Browser
#include "chromium.config"

# Mali
#include "gpu.config"

# NPU
#include "npu2.config"

# Video
#include "video_mpp.config"
#include "video_gst.config"
#include "video_gst_rtsp.config"

# Benchmark
#include "benchmark.config"

# Debug
#include "debug.config"
#include "test.config"

# Network
#include "network.config"
#include "wifi.config"
#include "bt.config"
BR2_PACKAGE_RKWIFIBT_BTUART="ttyS8"
```

## configs/rockchip_rk3568_uvc_defconfig
```kconfig
#include "base/base.config"
#include "chips/rk356x_aarch64.config"
#include "fs/exfat.config"
#include "fs/ntfs.config"
#include "fs/vfat.config"
#include "gpu/dummy.config"
#include "multimedia/audio.config"
#include "multimedia/camera.config"
#include "multimedia/mpp.config"
#include "wifibt/bt.config"
#include "wifibt/wireless.config"
#include "debug2.config"
#include "debug.config"
#include "test.config"
BR2_PACKAGE_AISERVER=y
BR2_PACKAGE_AISERVER_RKVO=y
BR2_PACKAGE_AISERVER_SHM_SERVER=y
BR2_PACKAGE_CALLFUNIPC=y
BR2_PACKAGE_CAMERA_ENGINE_RKAIQ_FORCE_INSTALL_TO_ROOTFS=y
BR2_PACKAGE_DBSERVER=y
BR2_PACKAGE_DBUS_GLIB=y
BR2_PACKAGE_GDB_DEBUGGER=y
BR2_PACKAGE_ISP2_IPC=y
BR2_PACKAGE_ISP2_IPC_DBSERVER=y
BR2_PACKAGE_ISP2_IPC_DBUS=y
BR2_PACKAGE_LIBIPCPROTOCOL=y
BR2_PACKAGE_LIBV4L=
BR2_PACKAGE_RKNPU2=y
BR2_PACKAGE_RK_OEM=y
BR2_PACKAGE_RK_OEM_RESOURCE_DIR="$(TOPDIR)/../device/rockchip/oem/oem_uvcc"
BR2_PACKAGE_ROCKCHIP_MPP=
BR2_PACKAGE_ROCKIT_MPI=y
BR2_PACKAGE_UAC_APP=y
BR2_PACKAGE_UVC_APP=y
BR2_PACKPAG_ISP2_IPC_FORCE_INSTALL_TO_ROOTFS=y
BR2_ROOTFS_OVERLAY+="board/rockchip/rk356x/fs-overlay-uvc/"
```

## configs/rockchip_rk3568j_yx_32_defconfig
```kconfig
#include "base/base.config"
#include "chips/rk3566_rk3568.config"
#include "yx.config"
BR2_arm=y
BR2_cortex_a55=y
BR2_PACKAGE_NTFS_3G_NTFSPROGS=
BR2_ROOTFS_OVERLAY+="board/rockchip/yx/fs-overlay/"
```

## configs/rockchip_rk356x_libs_defconfig
```kconfig
#include "base/base.config"
#include "chips/rk3566_rk3568_aarch64.config"
#include "gpu/dummy.config"
#include "multimedia/audio.config"
#include "multimedia/camera.config"
#include "multimedia/mpp.config"
# BR2_PACKAGE_ANDROID_TOOLS is reset to default
BR2_PACKAGE_CAMERA_ENGINE_RKAIQ_IQFILE="ov5695_TongJu_CHT842-MD.xml"
# BR2_PACKAGE_INPUT_EVENT_DAEMON is reset to default
# BR2_PACKAGE_PM_UTILS is reset to default
BR2_PACKAGE_RKNPU=y
BR2_PACKAGE_RKNPU_USE_RKNN_API=y
# BR2_PACKAGE_UPDATE is reset to default
# BR2_PACKAGE_UTIL_LINUX_MOUNT is reset to default
# BR2_PACKAGE_VENDOR_STORAGE is reset to default
# BR2_ROOTFS_DEVICE_CREATION_DYNAMIC_EUDEV is reset to default
BR2_ROOTFS_POST_BUILD_SCRIPT+="board/rockchip/rk3566_rk3568/post-script-bsp.sh"
```

## configs/rockchip_rk356x_nvr_defconfig
```kconfig
#include "base/nvr.config"
#include "chips/rk3566_rk3568_aarch64.config"
#include "gpu/nvr.config"
#include "multimedia/audio.config"
#include "multimedia/mpp.config"
#include "wifibt/network.config"
# BR2_PACKAGE_INPUT_EVENT_DAEMON is reset to default
# BR2_PACKAGE_PM_UTILS is reset to default
BR2_ROOTFS_OVERLAY+="board/rockchip/rk3566_rk3568/fs-overlay-nvr/"
```

## configs/rockchip_rk356x_nvr_recovery_defconfig
```kconfig
#include "base/nvr_recovery.config"
#include "chips/rk356x_aarch64.config"
BR2_ROOTFS_OVERLAY="board/rockchip/common/base board/rockchip/common/recovery board/rockchip/rk356x/fs-overlay/"
BR2_TARGET_ROOTFS_SQUASHFS=
```

## configs/rockchip_rk356x_nvr_spi_nand_defconfig
```kconfig
#include "base/nvr.config"
#include "chips/rk3566_rk3568_aarch64.config"
#include "fs/ubifs.config"
#include "gpu/nvr.config"
#include "multimedia/audio.config"
#include "multimedia/mpp.config"
#include "wifibt/network.config"
BR2_PACKAGE_INPUT_EVENT_DAEMON=
BR2_PACKAGE_PM_UTILS=
BR2_ROOTFS_OVERLAY+="board/rockchip/rk3566_rk3568/fs-overlay-nvr/"
BR2_TARGET_ROOTFS_CPIO=
```

## configs/rockchip_rk356x_ramboot_defconfig
```kconfig
#include "base/base.config"
#include "chips/rk356x_aarch64.config"
#include "tee_aarch64_v2.config"
BR2_PACKAGE_ANDROID_TOOLS=
BR2_PACKAGE_INPUT_EVENT_DAEMON=
BR2_PACKAGE_LUKSMETA=y
BR2_PACKAGE_PM_UTILS=
BR2_PACKAGE_RKSCRIPT=
BR2_PACKAGE_UPDATE=
BR2_PACKAGE_USBMOUNT=
BR2_PACKAGE_UTIL_LINUX_MOUNT=
BR2_PACKAGE_VENDOR_STORAGE=
BR2_ROOTFS_DEVICE_CREATION_DYNAMIC_EUDEV=
BR2_ROOTFS_OVERLAY+="board/rockchip/common/security-ramdisk-overlay/"
```

## configs/rockchip_rk356x_recovery_defconfig
```kconfig
#include "base/base.config"
#include "base/recovery.config"
#include "chips/rk356x_aarch64.config"
BR2_CCACHE=
BR2_PACKAGE_DOSFSTOOLS_FATLABEL=
BR2_PACKAGE_FATRESIZE=
BR2_PACKAGE_UPOWER=y
BR2_PACKAGE_UTIL_LINUX_MOUNT=
BR2_ROOTFS_MERGED_USR=
BR2_TARGET_GENERIC_ROOT_PASSWD=
BR2_PACKAGE_PARTED=
```

## configs/rockchip_rk3576_ipc_defconfig
```kconfig
#include "base/base.config"
#include "chips/rk3576_aarch64.config"
#include "fs/exfat.config"
#include "fs/ntfs.config"
#include "fs/vfat.config"
#include "gpu/gpu.config"
#include "multimedia/audio.config"
#include "multimedia/camera.config"
#include "multimedia/mpp.config"
#include "npu2.config"
#include "tools/gdb.config"
# BR2_PACKAGE_CAMERA_ENGINE is reset to default
BR2_PACKAGE_COMMON_ALGORITHM=y
BR2_PACKAGE_HOST_CMAKE=y
# BR2_PACKAGE_HOST_GDB_PYTHON is reset to default
BR2_PACKAGE_HOST_LINUX_HEADERS_CUSTOM_6_1=y
BR2_PACKAGE_IPCWEB_BACKEND=y
# BR2_PACKAGE_IPCWEB_BACKEND_JWT is not set
BR2_PACKAGE_IPCWEB_BACKEND_USE_RKIPC=y
BR2_PACKAGE_IVA=y
# BR2_PACKAGE_LIBMAD is reset to default
BR2_PACKAGE_LIBV4L_RKMPP=y
BR2_PACKAGE_NGINX=y
# BR2_PACKAGE_NGINX_HTTP_ACCESS_MODULE is not set
# BR2_PACKAGE_NGINX_HTTP_AUTH_BASIC_MODULE is not set
# BR2_PACKAGE_NGINX_HTTP_AUTOINDEX_MODULE is not set
# BR2_PACKAGE_NGINX_HTTP_BROWSER_MODULE is not set
# BR2_PACKAGE_NGINX_HTTP_CHARSET_MODULE is not set
# BR2_PACKAGE_NGINX_HTTP_EMPTY_GIF_MODULE is not set
BR2_PACKAGE_NGINX_HTTP_FLV_LIVE=y
# BR2_PACKAGE_NGINX_HTTP_GEO_MODULE is not set
# BR2_PACKAGE_NGINX_HTTP_LIMIT_CONN_MODULE is not set
# BR2_PACKAGE_NGINX_HTTP_LIMIT_REQ_MODULE is not set
# BR2_PACKAGE_NGINX_HTTP_MAP_MODULE is not set
# BR2_PACKAGE_NGINX_HTTP_MEMCACHED_MODULE is not set
# BR2_PACKAGE_NGINX_HTTP_PROXY_MODULE is not set
# BR2_PACKAGE_NGINX_HTTP_REFERER_MODULE is not set
# BR2_PACKAGE_NGINX_HTTP_SCGI_MODULE is not set
# BR2_PACKAGE_NGINX_HTTP_SPLIT_CLIENTS_MODULE is not set
# BR2_PACKAGE_NGINX_HTTP_SSI_MODULE is not set
# BR2_PACKAGE_NGINX_HTTP_UPSTREAM_IP_HASH_MODULE is not set
# BR2_PACKAGE_NGINX_HTTP_UPSTREAM_KEEPALIVE_MODULE is not set
# BR2_PACKAGE_NGINX_HTTP_UPSTREAM_LEAST_CONN_MODULE is not set
# BR2_PACKAGE_NGINX_HTTP_UPSTREAM_RANDOM_MODULE is not set
# BR2_PACKAGE_NGINX_HTTP_UPSTREAM_ZONE_MODULE is not set
# BR2_PACKAGE_NGINX_HTTP_USERID_MODULE is not set
# BR2_PACKAGE_NGINX_HTTP_UWSGI_MODULE is not set
BR2_PACKAGE_NTP=y
BR2_PACKAGE_PCRE=y
# BR2_PACKAGE_PULSEAUDIO is reset to default
BR2_PACKAGE_RKFSMK=y
BR2_PACKAGE_RKIPC=y
BR2_PACKAGE_RKIPC_RK3576=y
BR2_PACKAGE_ROCKCHIP_MALI_HAS_DUMMY=y
BR2_PACKAGE_ROCKCHIP_MALI_HAS_GBM=y
BR2_PACKAGE_ROCKCHIP_MPP_TESTS=y
```

## configs/rockchip_rk3588_base_defconfig
```kconfig
#include "base/base.config"
#include "chips/rk3588_aarch64.config"
#include "fs/vfat.config"
#include "gpu/dummy.config"
#include "multimedia/mpp.config"
#include "tools/extra.config"
#include "tools/common.config"
#include "tools/test.config"
BR2_PACKAGE_RKNPU=y
BR2_PACKAGE_RKNPU_USE_RKNN_API=y
```

## configs/rockchip_rk3588_defconfig
```kconfig
#include "audio.config"
#include "audio_gst.config"
#include "base/base.config"
#include "benchmark.config"
#include "bt.config"
#include "camera.config"
#include "camera_gst.config"
#include "debug.config"
#include "debug2.config"
#include "weston.config"
#include "gpu.config"
#include "network.config"
#include "ntfs.config"
#include "exfat.config"
#include "vfat.config"
#include "video_mpp.config"
#include "video_gst.config"
#include "video_gst_rtsp.config"
#include "chips/rk3588_aarch64.config"
#include "test.config"
BR2_PACKAGE_PULSEAUDIO=y
BR2_PACKAGE_PULSEAUDIO_DAEMON=y
BR2_PACKAGE_RKNPU2=y
```

## configs/rockchip_rk3588_nvr_defconfig
```kconfig
#include "base/nvr.config"
#include "chips/rk3588_aarch64.config"
#include "gpu/nvr.config"
#include "multimedia/audio.config"
#include "multimedia/mpp.config"
#include "toolchain/arm_10_aarch64.config"
#include "wifibt/network.config"
# BR2_PACKAGE_INPUT_EVENT_DAEMON is reset to default
# BR2_PACKAGE_PM_UTILS is reset to default
BR2_ROOTFS_OVERLAY+="board/rockchip/rk3588/fs-overlay-nvr/"
```

## configs/rockchip_rk3588_nvr_recovery_defconfig
```kconfig
#include "base/nvr_recovery.config"
#include "chips/rk3566_rk3568_aarch64.config"
BR2_ROOTFS_OVERLAY+="board/rockchip/rk3566_rk3568/fs-overlay/"
```
